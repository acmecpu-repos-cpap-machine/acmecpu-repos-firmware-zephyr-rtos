/*
 * Copyright (c) 2021 Acme CPU
 *
 * SPDX-License-Identifier: Apache-2.0
 */


&c201 { 

   sys_fan {
    compatible = "bsp-fan";
    status = "okay";
    pwms =  <&tim_2_pwm 2 65536 PWM_POLARITY_NORMAL>,
            <&tim_2_ic 1 65536 (1 << 3)>;
    pwm-names = "speed-ctrl",
                "speed-feedback";
    label = "SYS FAN";
   };

   /*blower {
	compatible = "acpu,blower";
	label = "BLOWER MOTOR";
	pwms = <&tim_2_pwm 2 65536 PWM_POLARITY_NORMAL>,
		<&tim_2_ic 1 65536 (1 << 3)>;
	pwm-names = "speed-ctrl",
		    "speed-feedback";

	dcdc-converter {
		label = "BOOST CONVERTER";
		enable-gpios = <&io_1 4 GPIO_OUTPUT_INACTIVE>;
		direction-gpios = <&io_1 8 GPIO_OUTPUT_INACTIVE>;
		io-channels = <&dac1 1>,
				<&adc1 6>;
		io-channel-names = "voltage-ctrl",
					"voltage-feedback";
		vref = <3300>;
		vfb = <1229>;
		v-i-conv-shunt = <2700>;
		vdiv-bot-resistor = <10000>;
		vdiv-top-resistor = <44200>;
		vdiv-aux-resistor = <11000>;
	};
   };*/
};
