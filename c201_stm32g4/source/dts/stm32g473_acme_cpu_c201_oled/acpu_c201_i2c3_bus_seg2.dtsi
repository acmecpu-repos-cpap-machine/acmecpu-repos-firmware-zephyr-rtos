/*
 * Copyright (c) 2021 Acme CPU
 *
 */

&i2c3_seg2 {

  ts3usbca4@5d {
    compatible = "ti,ts3usbca4";
    reg = <0x5d>;
    label = "USBC_SBU_MUX";
    oe-gpios = <&io_3 6 GPIO_ACTIVE_HIGH>;
  };
};
