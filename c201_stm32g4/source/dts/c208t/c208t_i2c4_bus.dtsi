/*
 * Copyright (c) 2024 Acme CPU
 *
 * C208T I2C4 bus has
 *		- BME280
 *		- INA226AIDGSR (Current sense)
 */

 &i2c4 {
 	status = "okay";
	pinctrl-0 = <&i2c4_scl_ph11 &i2c4_sda_pb7>;
	pinctrl-names = "default";
	clock-frequency = <I2C_BITRATE_FAST>;

	bme280@77 {
		compatible = "bosch,bme280";
		reg = <0x77>;
		label = "S203";
		status = "okay";
	};
	
	/*
	ina226@8a {
		compatible = "ti,ina226";
		reg = <0x138>;
		label = "Current_sense";
		status = "okay";
	};
	*/
};