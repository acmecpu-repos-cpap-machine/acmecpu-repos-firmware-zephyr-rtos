/*
 * Copyright (c) 2024 Acme CPU
 * - LCD backlight PWM
 */

&timers2 {
	status = "okay";
   	st,prescaler = <239>;	/* The counter clock frequency (CK_CNT) is equal to fCK_PSC / (PSC[15:0] + 1). */

	disp_bl_pwm: pwm {
    	status = "okay";
    	pinctrl-0 = <&tim2_ch1_pa15>;
    	pinctrl-names = "default";
	};
};
