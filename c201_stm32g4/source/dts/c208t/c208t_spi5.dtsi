/*
 * Copyright (c) 2024 Acme CPU
 *
 * The C208T SPI5 bus is connected to the 
 *
 */

&spi5 {
	status = "okay";
	pinctrl-0 = <&spi5_sck_ph6 &spi5_miso_ph7 &spi5_nss_ph5>;
	pinctrl-names = "default";
	/*
	dmas = <&dmamux1 2 38 0x20440
			&dmamux1 3 37 0x20480>;
	dma-names = "tx", "rx";
	*/
	/*
    adcs7476: adcs7476@0 {
            compatible = "ti,adcs7476";
            reg = <0>;
            status = "okay";
            spi-max-frequency = <24000000>;
    };
    */
};