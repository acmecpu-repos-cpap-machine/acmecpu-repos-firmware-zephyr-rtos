/*
 * Copyright (c) 2024 Acme CPU
 *
 */

&adc3 {
    pinctrl-0 = <&adc3_inp2_pf9>;
    pinctrl-names = "default";
    st,adc-clock-source = <SYNC>;
    st,adc-prescaler = <4>;
    status = "okay";
	#address-cells = <1>;
    #size-cells = <0>;
	vm: channel@2 {
		reg = <2>;
		zephyr,gain = "ADC_GAIN_1";
		zephyr,reference = "ADC_REF_INTERNAL";
		zephyr,acquisition-time = <ADC_ACQ_TIME_DEFAULT>;
		zephyr,resolution = <12>;
		zephyr,vref-mv = <3300>;
	};
};