/*
 * Copyright (c) 2024 Acme CPU
 *
 * Motor Driver USART Interface
 *
 */


&usart6 {
    status = "okay";
    pinctrl-0 = <&usart6_rx_pg9 &usart6_tx_pg14 &usart6_rts_pg8 &usart6_cts_pg13>;
    pinctrl-names = "default";
    current-speed = <921600>;
    hw-flow-control;
};
