/*
 * Copyright (c) 2022 Acme CPU
 *
 */


&c204 {
   sys_fan {
    compatible = "bsp-fan";
    status = "okay";
    pwms =  <&tim_2_pwm 2 65536 PWM_POLARITY_NORMAL>/*,
            <&tim_2_ic 1 65536 (1 << 3)>*/;
    pwm-names = "speed-ctrl"/*,
                "speed-feedback"*/;
    label = "SYS FAN";
   };
};
