/*
 * Copyright (c) 2022 Acme CPU
 *
 */


/{ c204: acpu-c204-board {

	mcu_gpios: mcu-gpio-signals {
		compatible = "bsp-gpios";

	};

	dio3_gpios: pe-gpio-3 {
		compatible = "bsp-gpios";

	};
	
   };
   
 };

#include "gpio_dt_defines.dtsi"


#include "c204_core_adc1.dtsi"
#include "c204_core_dac1.dtsi"
/*#include "c204_core_exti_ctrl.dtsi"*/
#include "c204_core_dma.dtsi"
#include "c204_core_i2c2_bus.dtsi"
#include "c204_core_i2c3_bus.dtsi"
#include "c204_core_i2c4_bus.dtsi"
#include "c204_core_qspi1_bus.dtsi"
#include "c204_core_spi2_bus.dtsi"
#include "c204_core_timers2.dtsi"
#include "c204_core_timers4.dtsi"
#include "c204_core_timers5.dtsi"
#include "c204_core_timers17.dtsi"
#include "c204_core_uart4.dtsi"
#include "c204_core_usart1.dtsi"
#include "c204_core_usart2.dtsi"
#include "c204_core_usart3.dtsi"
#include "c204_core_usb.dtsi"
#include "c204_core_ucpd.dtsi"

/*
 *	In this section we collect compound-type devices which may rely on several
 *	different nodes in the devicetree
 */

#include "c204_core_gpios.dtsi"	
#include "c204_core_motor_a2.dtsi"
#include "c204_core_stepper.dtsi"
#include "c204_core_user_interface.dtsi"
#include "c204_core_boost_converter.dtsi"
#include "c204_core_load_switch.dtsi"

/*
 *	Virtual devices which benefit from the devicetree
 */

#include "c204_core_stm32_flash_ob.dtsi"

