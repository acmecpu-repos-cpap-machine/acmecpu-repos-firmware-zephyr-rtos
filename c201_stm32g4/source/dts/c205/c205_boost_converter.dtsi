/*
 * Copyright (c) 2022 Acme CPU
 *
 */

/ {
	zephyr,user {
		dac = <&dac1>;
		dac-channel-id = <1>;
		dac-resolution = <12>;
		
		io-channels = <&adc1 8>;
	};
};

/*
&adc1 {
	#address-cells = <1>;
	#size-cells = <0>;

	vfan: channel@8 {
		reg = <8>;
		zephyr,gain = "ADC_GAIN_1";
		zephyr,reference = "ADC_REF_INTERNAL";
		zephyr,acquisition-time = <ADC_ACQ_TIME_DEFAULT>;
		zephyr,resolution = <12>;
	};
};
*/

&c204 { 
	tps55340 {
		compatible = "ti,tps55340";
		label = "BOOST CONVERTER";
		
		enable-gpios = <&gpiog 7 GPIO_PUSH_PULL>;
		
		/*io-channels = <&dac1 1>,
					  <&adc1 8>;
		io-channel-names = "voltage-ctrl",
						   "voltage-feedback";*/
		vref = <3300>;
		vfb = <1229>;
		v-i-conv-shunt = <2700>;
		vdiv-bot-resistor = <10000>;
		vdiv-top-resistor = <44200>;
		vdiv-aux-resistor = <11000>;
		
		adc-channel = <8>;
		dac-channel = <1>;
	};
};
