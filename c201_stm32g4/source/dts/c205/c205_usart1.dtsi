/*
 * Copyright (c) 2022 Acme CPU
 *
 * Debug Port
 *
 */


&usart1 {
    status = "okay";
    pinctrl-0 = <&usart1_rx_pc5 &usart1_tx_pc4>;
    pinctrl-names = "default";
    current-speed = <115200>;
};
