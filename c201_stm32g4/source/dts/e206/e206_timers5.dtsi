/*
 * Copyright (c) 2023 Acme CPU
 * - stepper motor 2 Vref PWM
 */

&timers5 {
	status = "okay";
   	st,prescaler = <239>;	/* The counter clock frequency (CK_CNT) is equal to fCK_PSC / (PSC[15:0] + 1). */
	
	stp2_vref_pwm: pwm {
		status = "okay";
    	pinctrl-0 = <&tim5_ch4_pi0>;
    	pinctrl-names = "default";
	};
};
