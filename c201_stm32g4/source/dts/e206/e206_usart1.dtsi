/*
 * Copyright (c) 2023 Acme CPU
 *
 * Debug Port
 *
 */


&usart1 {
    status = "okay";
    pinctrl-0 = <&usart1_rx_pa10 &usart1_tx_pa9>;
    pinctrl-names = "default";
    current-speed = <115200>;
};
