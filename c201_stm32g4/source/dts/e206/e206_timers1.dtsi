/*
 * Copyright (c) 2023 Acme CPU
 * - Buzzer
 */

&timers1 {
	status = "okay";
   	st,prescaler = <239>;	/* The counter clock frequency (CK_CNT) is equal to fCK_PSC / (PSC[15:0] + 1). */
	
	buzzer_pwm: pwm {
		status = "okay";
    	pinctrl-0 = <&tim1_ch1_pe9>;
    	pinctrl-names = "default";
	};
};
