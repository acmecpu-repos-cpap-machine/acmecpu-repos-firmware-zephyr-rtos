/*
 * Copyright (c) 2023 Acme CPU
 *
 */

&adc3 {
    pinctrl-0 = <&adc3_inp2_pf9>;
    pinctrl-names = "default";
    st,adc-clock-source = <SYNC>;
    st,adc-prescaler = <4>;
    status = "okay";

	#address-cells = <1>;
	#size-cells = <0>;
	
	vfan: channel@2 {
		reg = <2>;
		zephyr,gain = "ADC_GAIN_1";
		zephyr,reference = "ADC_REF_INTERNAL";
		zephyr,acquisition-time = <ADC_ACQ_TIME_DEFAULT>;
		zephyr,resolution = <12>;
	};
};