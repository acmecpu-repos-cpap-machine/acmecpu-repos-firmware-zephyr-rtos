/*
 * Copyright (c) 2023 Acme CPU
 *
 * Created on: 30-Jun-2023
 * Author: Rohan Dey (rohan@acmecpu.com)
 *
 * GPIO devices used
 *		- PS1 --> +3V3_AUD (audio power supply) controlled via AUX_PS_EN signal
 *		- PS2 --> uv led controlled via PWM_UV_LED3 signal
 */

/ {
    pwr_ctrl_gpios: pwr_ctrl_gpios {
		compatible = "acpu,pwrctrldrv";
		status = "okay";

        ps1-gpios = <&gpioi 8 (GPIO_PUSH_PULL)>;
        ps2-gpios = <&gpioe 5 (GPIO_PUSH_PULL)>;
    };
};