/*
 * Copyright (c) 2023 Acme CPU
 * - motor a2 speed control
 * - motor a2 speed sense
 */

&timers3 {
	status = "okay";
   	st,prescaler = <239>;	/* The counter clock frequency (CK_CNT) is equal to fCK_PSC / (PSC[15:0] + 1). */
	
	ma2_speed_ctrl: pwm {
		status = "okay";
    	pinctrl-0 = <&tim3_ch3_pb0>;
    	pinctrl-names = "default";
	};
/*
	ma2_speed_sense: input-capture {
    	compatible = "st,stm32-tim-ic";
    	status = "okay";
    	label = "TIM_2_IC";
    	pinctrl-0 = <&tim3_ch4_pb1>;
    	pinctrl-names = "default";
    	#pwm-cells = <3>;
	};*/
};
