/*
 * Copyright (c) 2023 Acme CPU
 *
 * Network Processor USART Interface
 *
 */


&usart3 {
    status = "okay";
    pinctrl-0 = <&usart3_rx_pb11 &usart3_tx_pb10 &usart3_rts_pd12 &usart3_cts_pd11>;
    pinctrl-names = "default";
    current-speed = <921600>;
    hw-flow-control;
    
/* 
	dmas = 	<&dmamux1 4 29 0x20440 0>,
			<&dmamux1 5 28 0x20480 0>;
	dma-names = "tx", "rx";
*/
};
