/*
 * Copyright (c) 2023 Acme CPU
 *
 * Thermistor using ADC
 */

/* E206 NTC thermistor NXFT15XH103FEAB050 */
/ { 
		ntc1: ntc1 {
		compatible = "ntc-thermistor-generic";
		status = "okay";
		io-channels = <&adc1 8>;
		pullup-uv = <3300000>;
		pullup-ohm = <5100>;
		pulldown-ohm = < 0 >;
		zephyr,compensation-table = 		 <(-40) 195652>,
                                             <(-39)	184917>,
                                             <(-38)	174845>,
                                             <(-37)	165391>,
                                             <(-36)	156513>,
                                             <(-35)	148171>,
                                             <(-34)	140330>,
                                             <(-33)	132958>,
                                             <(-32)	126022>,
                                             <(-31)	119494>,
                                             <(-30)	113347>,
                                             <(-29)	107565>,
                                             <(-28)	102116>,
                                             <(-27)	96978>,
                                             <(-26)	92132>,
                                             <(-25)	87559>,
                                             <(-24)	83242>,
                                             <(-23)	79166>,
                                             <(-22)	75316>,
                                             <(-21)	71677>,
                                             <(-20)	68237>,
                                             <(-19)	64991>,
                                             <(-18)	61919>,
                                             <(-17)	59011>,
                                             <(-16)	56258>,
                                             <(-15)	53650>,
                                             <(-14)	51178>,
                                             <(-13)	48835>,
                                             <(-12)	46613>,
                                             <(-11)	44506>,
                                             <(-10)	42506>,
                                             <(-9)	40600>,
                                             <(-8)	38791>,
                                             <(-7)	37073>,
                                             <(-6)	35442>,
                                             <(-5)	33892>,
                                             <(-4)	32420>,
                                             <(-3)	31020>,
                                             <(-2)	29689>,
                                             <(-1)	28423>,
                                             <(0)	27219>,
                                             <(1)	26076>,
                                             <(2)	24988>,
                                             <(3)	23951>,
                                             <(4)	22963>,
                                             <(5)	22021>,
                                             <(6)	21123>,
                                             <(7)	20267>,
                                             <(8)	19450>,
                                             <(9)	18670>,
                                             <(10)	17926>,
                                             <(11)	17214>,
                                             <(12)	16534>,
                                             <(13)	15886>,
                                             <(14)	15266>,
                                             <(15)	14674>,
                                             <(16)	14108>,
                                             <(17)	13566>,
                                             <(18)	13049>,
                                             <(19)	12554>,
                                             <(20)	12081>,
                                             <(21)	11628>,
                                             <(22)	11195>,
                                             <(23)	10780>,
                                             <(24)	10382>,
                                             <(25)	10000>,
                                             <(26)	9634>,
                                             <(27)	9284>,
                                             <(28)	8947>,
                                             <(29)	8624>,
                                             <(30)	8315>,
                                             <(31)	8018>,
                                             <(32)	7734>,
                                             <(33)	7461>,
                                             <(34)	7199>,
                                             <(35)	6948>,
                                             <(36)	6707>,
                                             <(37)	6475>,
                                             <(38)	6253>,
                                             <(39)	6039>,
                                             <(40)	5834>,
                                             <(41)	5636>,
                                             <(42)	5445>,
                                             <(43)	5262>,
                                             <(44)	5086>,
                                             <(45)	4917>,
                                             <(46)	4754>,
                                             <(47)	4597>,
                                             <(48)	4446>,
                                             <(49)	4301>,
                                             <(50)	4161>,
                                             <(51)	4026>,
                                             <(52)	3896>,
                                             <(53)	3771>,
                                             <(54)	3651>,
                                             <(55)	3535>,
                                             <(56)	3423>,
                                             <(57)	3315>,
                                             <(58)	3211>,
                                             <(59)	3111>,
                                             <(60)	3014>,
                                             <(61)	2922>,
                                             <(62)	2834>,
                                             <(63)	2748>,
                                             <(64)	2666>,
                                             <(65)	2586>,
                                             <(66)	2509>,
                                             <(67)	2435>,
                                             <(68)	2364>,
                                             <(69)	2294>,
                                             <(70)	2228>,
                                             <(71)	2163>,
                                             <(72)	2100>,
                                             <(73)	2040>,
                                             <(74)	1981>,
                                             <(75)	1925>,
                                             <(76)	1870>,
                                             <(77)	1817>,
                                             <(78)	1766>,
                                             <(79)	1716>,
                                             <(80)	1669>,
                                             <(81)	1622>,
                                             <(82)	1578>,
                                             <(83)	1535>,
                                             <(84)	1493>,
                                             <(85)	1452>,
                                             <(86)	1413>,
                                             <(87)	1375>,
                                             <(88)	1338>,
                                             <(89)	1303>,
                                             <(90)	1268>,
                                             <(91)	1234>,
                                             <(92)	1202>,
                                             <(93)	1170>,
                                             <(94)	1139>,
                                             <(95)	1110>,
                                             <(96)	1081>,
                                             <(97)	1053>,
                                             <(98)	1026>,
                                             <(99)	999>,
                                             <(100)	974>,
                                             <(101)	949>,
                                             <(102)	925>,
                                             <(103)	902>,
                                             <(104)	880>,
                                             <(105)	858>,
                                             <(106)	837>,
                                             <(107)	816>,
                                             <(108)	796>,
                                             <(109)	777>,
                                             <(110)	758>,
                                             <(111)	740>,
                                             <(112)	722>,
                                             <(113)	705>,
                                             <(114)	688>,
                                             <(115)	672>,
                                             <(116)	656>,
                                             <(117)	640>,
                                             <(118)	625>,
                                             <(119)	611>,
                                             <(120)	596>,
                                             <(121)	583>,
                                             <(122)	569>,
                                             <(123)	556>,
                                             <(124)	544>,
                                             <(125)	531>;
	};
};	

/* E206 NTC thermistor NXFT15XH103FEAB050 */
/ { 
		ntc2: ntc2 {
		compatible = "ntc-thermistor-generic";
		status = "okay";
		io-channels = <&adc1 19>;
		pullup-uv = <3300000>;
		pullup-ohm = <5100>;
		pulldown-ohm = < 0 >;
		zephyr,compensation-table = 		 <(-40) 195652>,
                                             <(-39)	184917>,
                                             <(-38)	174845>,
                                             <(-37)	165391>,
                                             <(-36)	156513>,
                                             <(-35)	148171>,
                                             <(-34)	140330>,
                                             <(-33)	132958>,
                                             <(-32)	126022>,
                                             <(-31)	119494>,
                                             <(-30)	113347>,
                                             <(-29)	107565>,
                                             <(-28)	102116>,
                                             <(-27)	96978>,
                                             <(-26)	92132>,
                                             <(-25)	87559>,
                                             <(-24)	83242>,
                                             <(-23)	79166>,
                                             <(-22)	75316>,
                                             <(-21)	71677>,
                                             <(-20)	68237>,
                                             <(-19)	64991>,
                                             <(-18)	61919>,
                                             <(-17)	59011>,
                                             <(-16)	56258>,
                                             <(-15)	53650>,
                                             <(-14)	51178>,
                                             <(-13)	48835>,
                                             <(-12)	46613>,
                                             <(-11)	44506>,
                                             <(-10)	42506>,
                                             <(-9)	40600>,
                                             <(-8)	38791>,
                                             <(-7)	37073>,
                                             <(-6)	35442>,
                                             <(-5)	33892>,
                                             <(-4)	32420>,
                                             <(-3)	31020>,
                                             <(-2)	29689>,
                                             <(-1)	28423>,
                                             <(0)	27219>,
                                             <(1)	26076>,
                                             <(2)	24988>,
                                             <(3)	23951>,
                                             <(4)	22963>,
                                             <(5)	22021>,
                                             <(6)	21123>,
                                             <(7)	20267>,
                                             <(8)	19450>,
                                             <(9)	18670>,
                                             <(10)	17926>,
                                             <(11)	17214>,
                                             <(12)	16534>,
                                             <(13)	15886>,
                                             <(14)	15266>,
                                             <(15)	14674>,
                                             <(16)	14108>,
                                             <(17)	13566>,
                                             <(18)	13049>,
                                             <(19)	12554>,
                                             <(20)	12081>,
                                             <(21)	11628>,
                                             <(22)	11195>,
                                             <(23)	10780>,
                                             <(24)	10382>,
                                             <(25)	10000>,
                                             <(26)	9634>,
                                             <(27)	9284>,
                                             <(28)	8947>,
                                             <(29)	8624>,
                                             <(30)	8315>,
                                             <(31)	8018>,
                                             <(32)	7734>,
                                             <(33)	7461>,
                                             <(34)	7199>,
                                             <(35)	6948>,
                                             <(36)	6707>,
                                             <(37)	6475>,
                                             <(38)	6253>,
                                             <(39)	6039>,
                                             <(40)	5834>,
                                             <(41)	5636>,
                                             <(42)	5445>,
                                             <(43)	5262>,
                                             <(44)	5086>,
                                             <(45)	4917>,
                                             <(46)	4754>,
                                             <(47)	4597>,
                                             <(48)	4446>,
                                             <(49)	4301>,
                                             <(50)	4161>,
                                             <(51)	4026>,
                                             <(52)	3896>,
                                             <(53)	3771>,
                                             <(54)	3651>,
                                             <(55)	3535>,
                                             <(56)	3423>,
                                             <(57)	3315>,
                                             <(58)	3211>,
                                             <(59)	3111>,
                                             <(60)	3014>,
                                             <(61)	2922>,
                                             <(62)	2834>,
                                             <(63)	2748>,
                                             <(64)	2666>,
                                             <(65)	2586>,
                                             <(66)	2509>,
                                             <(67)	2435>,
                                             <(68)	2364>,
                                             <(69)	2294>,
                                             <(70)	2228>,
                                             <(71)	2163>,
                                             <(72)	2100>,
                                             <(73)	2040>,
                                             <(74)	1981>,
                                             <(75)	1925>,
                                             <(76)	1870>,
                                             <(77)	1817>,
                                             <(78)	1766>,
                                             <(79)	1716>,
                                             <(80)	1669>,
                                             <(81)	1622>,
                                             <(82)	1578>,
                                             <(83)	1535>,
                                             <(84)	1493>,
                                             <(85)	1452>,
                                             <(86)	1413>,
                                             <(87)	1375>,
                                             <(88)	1338>,
                                             <(89)	1303>,
                                             <(90)	1268>,
                                             <(91)	1234>,
                                             <(92)	1202>,
                                             <(93)	1170>,
                                             <(94)	1139>,
                                             <(95)	1110>,
                                             <(96)	1081>,
                                             <(97)	1053>,
                                             <(98)	1026>,
                                             <(99)	999>,
                                             <(100)	974>,
                                             <(101)	949>,
                                             <(102)	925>,
                                             <(103)	902>,
                                             <(104)	880>,
                                             <(105)	858>,
                                             <(106)	837>,
                                             <(107)	816>,
                                             <(108)	796>,
                                             <(109)	777>,
                                             <(110)	758>,
                                             <(111)	740>,
                                             <(112)	722>,
                                             <(113)	705>,
                                             <(114)	688>,
                                             <(115)	672>,
                                             <(116)	656>,
                                             <(117)	640>,
                                             <(118)	625>,
                                             <(119)	611>,
                                             <(120)	596>,
                                             <(121)	583>,
                                             <(122)	569>,
                                             <(123)	556>,
                                             <(124)	544>,
                                             <(125)	531>;
	};
};
