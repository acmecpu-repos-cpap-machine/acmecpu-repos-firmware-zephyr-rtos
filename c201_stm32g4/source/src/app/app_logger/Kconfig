## c201_stm32g4/source/src/app/app_matrix_keypad/Kconfig
```kconfig
# Copyright (c) 2023 Acme CPU
# App matrix keypad configurations

menuconfig APP_MATRIX_KEYPAD
	bool "App matrix keypad configurations"
	default n
	help
	  Enable / disable App matrix keypad
```

## c201_stm32g4/source/src/app/app_net/Kconfig
```kconfig
# Copyright (c) 2023 Acme CPU
# App Network configurations 

menuconfig APP_NET
	bool "App Network configurations"
	default n
	help
	  App Network configurations
	  
if APP_NET

config APP_HAS_HTML_GEN
	bool "Application has HTML generater"
	default n
	help
	  Application has HTML generater (y/n)
	  
config APP_HTML_MENU_SORT
	bool "The HTML generater will sort the menu based on display order"
	default n
	help
	  Whether the HTML generater will sort the menu based on display order

endif # APP_NET
```

## c201_stm32g4/source/src/app/app_settings/Kconfig
```kconfig
# Copyright (c) 2021 Acme CPU
# Application Settings configuration options

menuconfig APP_SETTINGS
#	bool
	bool "Application Settings Configurations"
	default y
	help
	  Application Settings Configurations 

if APP_SETTINGS

config APP_SETTINGS_DEVELOPER_MODE
	bool "Enable developer mode settings" 
	default n
	help
	  Enable developer mode settings 

config APP_SETTINGS_LOG_DIR_NAME
	string "Settings log directory name" 
	default "settings"
	help
	  Settings log directory name 

config APP_SETTINGS_LOG_CURR_FILE_NAME
	string "Settings current log file name"
	default "settings.dat"
	help
	  Settings current log file name 

config APP_SETTINGS_LOG_CURR_FILE_SIZE_MAX_MB
	int "Settings current log file max size in MB"
	default 1
	help
	  Settings current log file max size in MB 

config APP_SETTINGS_LOG_MAX_FILE_COUNT
	int "Settings log max file count for log rotation"
	default 3
	help
	  Settings log max file count for log rotation
	  
config APP_SETTINGS_DISPVAL_LOAD_TO_RAM
	bool "All settings values will be loaded to ram if enabled" 
	default n
	help
	  All settings values will be loaded to ram if enabled.
	  This consumes more heap memory. This feature will offer better performance. 

rsource "Kconfig.settings"

endif # APP_SETTINGS
```

## c201_stm32g4/source/src/app/app_settings/Kconfig.settings
```kconfig
# Copyright (c) 2024 Acme CPU
# Application Settings Download configuration options

config APP_SETTINGS_DNL_DIR_NAME
	string "Settings log directory name" 
	default "settings"
	help
	  Settings log directory name 

config APP_SETTINGS_DNL_CURR_FILE_NAME
	string "Settings current log file name"
	default "settingsdnl.csv"
	help
	  Settings current log file name 

config APP_SETTINGS_DNL_FILE_SIZE_MAX_MB
	int "Settings current log file max size in MB"
	default 5
	help
	  Settings current log file max size in MB 

config APP_SETTINGS_DNL_MAX_FILE_COUNT
	int "Settings log max file count for log rotation"
	default 1
	help
	  Settings log max file count for log rotation


config APP_SETTINGS_DNL_FILE_URL
	string "Settings file download URL"
	default "http://192.168.73.103:8080/textfile.txt"
	help
	  Settings file download URL

	
```

## c201_stm32g4/source/src/app/app_shellcmd/Kconfig
```kconfig
# Copyright (c) 2021 Acme CPU
# Shell commands application configurations 

menuconfig APP_SHELLCMD
	bool "Shell commands"
	default y
	depends on SHELL
	help
	  Enable / disable shell commands

if APP_SHELLCMD

config APP_TEST_CMDS
	bool "Enable / disable testing shell commands"
	default n
	help
		Enable / disable testing shell commands		

endif # APP_SHELLCMD
```

## c201_stm32g4/source/src/app/app_stepper/Kconfig
```kconfig
# Copyright (c) 2021 Acme CPU
# Application Stepper Motor configuration options

menuconfig APP_STEPPER
	bool "Application Stepper Motor Configurations"
	default y
	help
	  Application Stepper Motor Configurations 

if APP_STEPPER

config STEPPER_RESET_POSITION
	int "Default Reset position in degrees"
	default 0
	range 0 360
	help
	  Reset position of the stepper motor in degrees

config STEPPER_STEP_SPEED_HZ
	int "Default step speed in Hz"
	default 500
	range 0 5000000
	help
	  Default step speed in Hz
	  
config STEPPER_NUM_ROTATION_TO_RESET
	int "Number of rotations to Reset position"
	default 10
	range 0 10000
	help
	  Number of rotations required to bring the stepper to reset position

choice
	prompt "Direction of rotation to go to reset position"
	config DIR_ANTICLOCKWISE
		bool "Anti clockwise"

	config DIR_CLOCKWISE
		bool "Clockwise"
endchoice

config STEPPER_RESET_DIRECTION
	int 
	default 1 if DIR_ANTICLOCKWISE
	default 0 if DIR_CLOCKWISE
	  
choice
	prompt "Select default step mode"

	config STEP_MODE_FULL
		bool "Full step"

	config STEP_MODE_HALF
		bool "Half step"

	config STEP_MODE_1_4TH
		bool "1/4th step"

	config STEP_MODE_1_8TH
		bool "1/8th step"

	config STEP_MODE_1_16TH
		bool "1/16th step"

	config STEP_MODE_1_32ND
		bool "1/32nd step"

	config STEP_MODE_1_64TH
		bool "1/64th step"

	config STEP_MODE_1_128TH
		bool "1/128th step"

	config STEP_MODE_1_256TH
		bool "1/256th step"
endchoice

config STEPPER_STEP_MODE
	int
	#default 2
	default 1 if STEP_MODE_FULL
	default 2 if STEP_MODE_HALF
	default 4 if STEP_MODE_1_4TH
	default 8 if STEP_MODE_1_8TH
	default 16 if STEP_MODE_1_16TH
	default 32 if STEP_MODE_1_32ND
	default 64 if STEP_MODE_1_64TH
	default 128 if STEP_MODE_1_128TH
	default 256 if STEP_MODE_1_256TH

# Select the motor to be used in the application	  
rsource "Kconfig.part"

endif # APP_STEPPER
```

## c201_stm32g4/source/src/app/app_stepper/Kconfig.part
```kconfig
# Copyright (c) 2021 Acme CPU
# Choice of stepper motor used for the application

menuconfig APP_STEPPER_PART
	bool "Select the Stepper Motor"
	default y
	help
	  Select the Stepper Motor (do not disable) 

if APP_STEPPER_PART
choice
	prompt "Stepper Motor Selection"
	default STEPPER_MOTOR_B101

	config STEPPER_MOTOR_B101
		bool "Stepper Motor B101"
		help
		  Stepper Motor B101
	
	config STEPPER_MOTOR_B102
		bool "Stepper Motor B102"
		help
		  Stepper Motor B102 

endchoice


if STEPPER_MOTOR_B101
	rsource "Kconfig.stepperb101"
endif

if STEPPER_MOTOR_B102
	rsource "Kconfig.stepperb102"
endif

endif # APP_STEPPER_PART
```

## c201_stm32g4/source/src/app/app_stepper/Kconfig.stepperb101
```kconfig
# Copyright (c) 2021 Acme CPU
# Stepper Motor B101 configuration options

config FULL_STEP_ANGLE
	int "Full step angle of the motor in degrees"
	range 1 360
	default 18
	help
		Full step angle of the motor in degrees
```

## c201_stm32g4/source/src/app/app_stepper/Kconfig.stepperb102
```kconfig
# Copyright (c) 2021 Acme CPU
# Stepper Motor B102 configuration options

config FULL_STEP_ANGLE
	int "Full step angle of the motor in degrees"
	range 1 360
	default 36
	help
		Full step angle of the motor in degrees
```

## c201_stm32g4/source/src/app/app_time/Kconfig
```kconfig
# Copyright (c) 2021 Acme CPU
# Application Time configurations

menuconfig APP_TIME
	bool "Application Time Configurations"
	default y
	help
	  Application time module is always enabled. Disabling it has no effect 

if APP_TIME

config TIME_MIN_VALUE_SECONDS
	int "Current time should never be less than this time measured in seconds"
	default 1619827200
	help
	    Current time should never be less than this time measured in seconds
	    If the acquired time from the RTC is less than this time, then
	    user must be prompted to setup the time. If user does not setup the time
	    then the system will use this time as a default value

endif # APP_TIME
```

## c201_stm32g4/source/src/app/app_uart_m2m_com/Kconfig
```kconfig
# Copyright (c) 2022 Acme CPU
# UART based M2M communication application configuration

menuconfig APP_UART_M2M
	bool "UART based M2M communication application configuration"
	default y
	help
	  UART based M2M communication application configuration 

if APP_UART_M2M

config UART_M2M_BUFFER_SIZE
	int "UART M2M buffer size"
	default 512
	help
	    UART M2M buffer size for received characters or characters to send


rsource "app_wifi_bt/Kconfig"
rsource "app_bldc_drv/Kconfig"

endif # APP_UART_M2M
```

## c201_stm32g4/source/src/app/app_ucpd/Kconfig
```kconfig
# Copyright (c) 2022 Acme CPU
# App UCPD configurations

menuconfig APP_UCPD
	bool "Enable / disable USB Power Delivery"
	default n
	help
	  Enable / disable USB Power Delivery

if APP_UCPD

config APP_MVOLT_MAX
	int "Max VBUS (mV) supported by the application"
	default 5000
	range 5000 20000
	help
	  Max VBUS (mV) supported by the application
	  
endif	# APP_UCPD

menuconfig APP_UCPD_EXT_CONTR
	bool "Enable / disable UCPD external controller app and shell commands"
	default n
	help
		Enable / disable UCPD external controller app and commands.
		If this is enabled then ucpd shell commands are activated. 

if APP_UCPD_EXT_CONTR

config APP_MVOLT_MAX
	int "Max VBUS (mV) supported by the application"
	default 5000
	range 5000 20000
	help
	  Max VBUS (mV) supported by the application

endif # APP_UCPD_EXT_CONTR
```

## c201_stm32g4/source/src/app/app_utils/Kconfig
```kconfig
# Copyright (c) 2023 Acme CPU

menuconfig APP_UTILS
	bool "Utils for the application"
	default y
	help
	  Utils for the application

if APP_UTILS

config APP_MENU_SORT_UTIL
	bool "Enable / disable utils for settings menu"
	default n
	help
		Enable / disable utils for settings menu		

endif # APP_UTILS
```

## c201_stm32g4/source/src/bsp/Kconfig
```kconfig
# Copyright (c) 2021 Acme CPU

#rsource "bsp_fs_helper/Kconfig"
rsource "bsp_membrane_switch/Kconfig"
```

## c201_stm32g4/source/src/bsp/bsp_aux_power/Kconfig
```kconfig
# Copyright (c) 2021 Acme CPU
# Load Switch configuration options

config C201_AUXILIARY_POWER
	bool "Enable Auxiliary power for sensor circuit"
	default y
	help
	  Enable or disable auxiliary power for sensor circuit through a load switch

if C201_AUXILIARY_POWER

rsource "Kconfig.part"

endif # C201_AUXILIARY_POWER
```

## c201_stm32g4/source/src/bsp/bsp_fs_helper/Kconfig
```kconfig
# Copyright (c) 2021 Acme CPU
# BSP File System configuration options

menuconfig BSP_FILE_SYSTEM
	bool "BSP File System Configurations"
	default y
	help
	  Do not disable 

if BSP_FILE_SYSTEM

config BSP_FS_SD_CARD_FAT_MOUNT_POINT
	string "SD Card FAT file system mount point path"
	default "/SD:"
	help
	    SD Card mount point path

config BSP_FS_FLASH_FAT_MOUNT_POINT
	string "Flash FAT file system mount point path"
	default "/NAND:"
	help
	    SD Card mount point path

endif # BSP_FILE_SYSTEM
```

## c201_stm32g4/source/src/bsp/bsp_membrane_switch/Kconfig
```kconfig
# Copyright (c) 2021 Acme CPU
# Configurations for a membrane switch used in the application 

menuconfig BSP_MEMBRANE_SWITCH
#	bool
	bool "Membrane Switch configurations"
	default y
	help
	  Enable or disable the membrane switch module 

if BSP_MEMBRANE_SWITCH

config SWITCH_EDGE_NORMAL_PRESS_DURATION_MS_MIN
	int "(EDGE TRIG) Min time in milli seconds a switch must stay asserted for normal press detection"
	range 50 500
	default 150
	help
	    A normal switch press is considered valid if the time (in milli seconds) from the moment an interrupt is detected is
	    more than this time

config SWITCH_EDGE_LONG_PRESS_DURATION_MS_MIN
	int "(EDGE TRIG) Min time in milli seconds a switch must stay asserted for long press detection"
	range 2000 10000
	default 3000
	help
	    A long switch press is considered valid if the time (in milli seconds) from the moment an interrupt is detected is
	    more than this time

config SWITCH_LEVEL_NORMAL_PRESS_DURATION_MS_MIN
	int "(LEVEL TRIG) Min time in milli seconds a switch must stay asserted for normal press detection"
	range 50 500
	default 200
	help
	    A normal switch press is considered valid if the time (in milli seconds) from the moment an interrupt is detected is
	    more than this time

config SWITCH_LEVEL_NORMAL_PRESS_DURATION_MS_MAX
	int "(LEVEL TRIG) Max time in milli seconds a switch can stay asserted for normal press detection"
	range 500 2000
	default 800
	help
	    The maximum time helps to rule out incorrect data.


endif # BSP_MEMBRANE_SWITCH
```

## c201_stm32g4/source/src/lib/Kconfig
```kconfig
# Copyright (c) 2022 Acme CPU

rsource "lib_pid/Kconfig"
rsource "lib_push_switch/Kconfig"
rsource "lib_file_oper/Kconfig"
rsource "lib_matrix_keypad/Kconfig"
rsource "lib_m2m_frame/Kconfig"
rsource "lib_stm32bl_host/Kconfig"
```

## c201_stm32g4/source/src/lib/lib_pid/Kconfig
```kconfig
# Copyright (c) 2021 Acme CPU
# Configurations for PID control library 

menuconfig LIB_PID_CONTROL
	bool "PID control library"
	default y
	help
	  Enable or disable the PID control library to be used in the application 
```
