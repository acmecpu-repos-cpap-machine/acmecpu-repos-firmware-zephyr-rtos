## c201_stm32g4/source/src/app/app_heater/Kconfig.heater12W
```kconfig
# Copyright (c) 2024 Acme CPU
# Heater 12W configrations

config HEATER_12W_TEMP_MAX
	int "Maximum temperature in C for heater 12W"
	range 25 65
	default 60
	help
		The Maximum temperature in centegrate for heater 12W which can function
		
config HEATER_12W_TEMP_MIN
	int "Minimum temperature in C for heater 12W"
	range 25 65
	default 25
	help
		The Minimum temperature in centegrate for heater 12W which can function	

config RETRY_COUNTER_12W
	int "Counter value set for retrying for heater 12W"
	default 10
	help
		The number of retrials can happen to fetch the data from sensor
			
```

## c201_stm32g4/source/src/app/app_heater/Kconfig.heater24W
```kconfig
# Copyright (c) 2024 Acme CPU
# Heater 24W configrations

config HEATER_24W_HUMIDITY_MAX
	int "Maximum humidity in percentage for heater 24W"
	range 40 80
	default 80
	help
		The Maximum humidity in percentage for heater 24W which can function
		
config HEATER_24W_HUMIDITY_MIN
	int "Minimum humidity in percentage for heater 24W"
	range 40 80
	default 40
	help
		The Minimum humidity in percentage for heater 24W which can function	

config RETRY_COUNTER_24W
	int "Counter value set for retrying for heater 24W"
	default 15
	help
		The number of retrials can happen to fetch the data from sensor	
```

## c201_stm32g4/source/src/app/app_imu_algo/Kconfig
```kconfig
# Copyright (c) 2024 Acme CPU
# Application BMI algorithms

config BMI270
	bool "Application BMI algorithms"
	default n
	help
	  Enable or disable the bmi sensor
```

## c201_stm32g4/source/src/app/app_led/Kconfig
```kconfig
# Copyright (c) 2022 Acme CPU
# Application LED notification configurations

menuconfig APP_LED_NOTIFICATION
	bool "Application LED notification configurations"
	default n
#	depends on BSP_LEDS
	help
	  Application LED notification module.
	  Disable all of the following to turn off led feature and lower memory footprint
	  	- CONFIG_APP_LED_NOTIFICATION
	  	- CONFIG_BSP_LEDS
	  	- led driver (eg. CONFIG_PCA9632)
	  	- CONFIG_LED

if APP_LED_NOTIFICATION

endif # APP_LED_NOTIFICATION
```
