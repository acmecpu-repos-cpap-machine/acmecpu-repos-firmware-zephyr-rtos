## c201_stm32g4/source/src/Kconfig
```kconfig
# Copyright (c) 2021 Acme CPU

menu "ACPU C201 Application Configurations"

rsource "app/Kconfig"
rsource "bsp/Kconfig"
rsource "lib/Kconfig"

endmenu
```

## c201_stm32g4/source/src/app/Kconfig
```kconfig
# Copyright (c) 2021 Acme CPU

rsource "app_battery/Kconfig"
rsource "app_blower/Kconfig"
rsource "app_logger/Kconfig"
#rsource "app_data_recorder/Kconfig"
rsource "app_settings/Kconfig"
#rsource "app_membrane_switch/Kconfig"
rsource "app_devcmd/Kconfig"
rsource "app_time/Kconfig"
rsource "app_stepper/Kconfig"
rsource "app_display/Kconfig"
rsource "app_sensor/Kconfig"
rsource "app_shellcmd/Kconfig"
rsource "app_uart_m2m_com/Kconfig"
rsource "app_led/Kconfig"
rsource "app_push_switch/Kconfig"
rsource "app_ucpd/Kconfig"
rsource "app_storage/Kconfig"
rsource "app_analog/Kconfig"
rsource "app_net/Kconfig"
rsource "app_matrix_keypad/Kconfig"
rsource "app_utils/Kconfig"
rsource "app_heater/Kconfig"
rsource "app_fluid_level/Kconfig"
rsource "app_dfu/Kconfig"
rsource "app_imu_algo/Kconfig"
```

## c201_stm32g4/source/src/app/app_battery/Kconfig
```kconfig
# Copyright (c) 2021 Acme CPU
# Battery application configurations 

menuconfig APP_BATTERY
	bool "Device Battery configurations"
	default y
	help
	  Device battery configurations
	  
if APP_BATTERY

config APP_CHARGER
	bool "Enable / disable charger app"
	default n
	help
		Enable / disable charger app. If this is enabled then charger shell commands
		are activated
		
config APP_CHARGING_CURR_PERCENT_OF_AVAILABLE_CURRENT
	int "Percentage of charging current of available current from the charger to be used for battery charging"
#	depends on APP_CHARGER
	range 10 100
	default 70
	help
	  Percentage of charging current of available current from the charger to be used for battery charging
		
config APP_BATTERY_MIN_VALUE_MVOLTS
	int "Battery minimmum value in mili volts"
	default 3000
	help
	  Battery minimmum value in mili volts. This is value at which the  
	  battery level should be 0% 

config APP_BATTERY_MAX_VALUE_MVOLTS
	int "Battery maximum value in mili volts"
	default 4200
	help
	  Battery maximum value in mili volts. This is value at which the  
	  battery level should be 100%

config APP_BATTERY_VALUE_NORMALIZE_COUNT
	int "Acquired battery value averaging count"
	default 80
	help
		The number of time the battery voltage should be averaged
		so that there is less or no fluctuations in the reading

config APP_BATTERY_CHARGE_CURRENT_LIMIT
	int "Battery charging current limit in mV"
	range 500 5000
	default 3000
	help
		The battery charging current limit to be set into the battery charger chip.
		This is based on the type of battery attached to the application
		
config APP_BATTERY_MAX_CAPACITY_MAH
	int "Maximum battery capacity in mah"
	range 100 20000
	default 5000
	help
		Maximum battery capacity in mah
				
endif # APP_BATTERY

# add ucpd configurations to the application
rsource "Kconfig.ucpd"
```

## c201_stm32g4/source/src/app/app_battery/Kconfig.ucpd
```kconfig
# Copyright (c) 2021 Acme CPU
# USB C Power Delivery configurations 

menuconfig APP_USBC_PD
	bool "USB Type-C Power Delivery"
	help
	  USB Type-C Power Delivery configurations
	  
if APP_USBC_PD

config USBPD_PORT_COUNT
	int "Number of USB C Power Delivery Ports"
	range 1 2
	default 1
	help
		Number of USB C Power Delivery Ports
				
endif # APP_USBC_PD
```

## c201_stm32g4/source/src/app/app_blower/Kconfig
```kconfig
# Copyright (c) 2021 Acme CPU
# Blower configuration options

menuconfig APP_BLOWER
	bool "App Blower Configurations"
	default y
	help
	  Enable or disable the blower

if APP_BLOWER

rsource "Kconfig.part"

config APP_BLOWER_SENSOR_LOG_DIR_NAME
	string "Blower sensor log directory name"
	default "sensor"
	help
	  Blower sensor log directory name 

config APP_BLOWER_SENSOR_LOG_CURR_FILE_NAME
	string "Blower sensor current log file name"
	default "sensor.dat"
	help
	  Blower sensor current log file name 

config APP_BLOWER_SENSOR_LOG_CURR_FILE_SIZE_MAX_MB
	int "Blower sensor current log file max size in MB"
	default 3
	help
	  Blower sensor current log file max size in MB 

config APP_BLOWER_SENSOR_LOG_MAX_FILE_COUNT
	int "Blower sensor log max file count for log rotation"
	default 5
	help
	  Blower sensor log max file count for log rotation 

config APP_BLOWER_VOLTAGE_SLOPE_CONTROL
	bool "Enable or disable blower voltage slope controlled logic in PID loop"
	default n
	help
		Enable or disable blower voltage slope controlled logic in PID loop
	
endif # APP_BLOWER
```

## c201_stm32g4/source/src/app/app_blower/Kconfig.blowera101
```kconfig
# Copyright (c) 2022 Acme CPU
# Blower motor A101 configurations

config BLOWER_MOTOR_A101_MVOLTS_MIN
	int "Minimum voltage in mV for Blower Motor A101"
	range 8000 14000
	default 9000
	help
		The minimum voltage at which blower motor A101 can function
		
config BLOWER_MOTOR_A101_MVOLTS_MAX
	int "Maximum voltage in mV for Blower Motor A101"
	range 12000 24000
	default 24000
	help
		The maximum voltage at which blower motor A101 can function 
		
config BLOWER_MOTOR_A101_SPEED_RPM_MIN
	int "Minimum speed in RPM for Blower Motor A101"
	range 10000 20000
	default 10000
	help
		Minimum speed in RPM for Blower Motor A101
	
config BLOWER_MOTOR_A101_SPEED_RPM_MAX
	int "Maximum speed in RPM for Blower Motor A101"
	range 20000 50000
	default 40000
	help
		Maximum speed in RPM for Blower Motor A101
	
```

## c201_stm32g4/source/src/app/app_blower/Kconfig.blowera102
```kconfig
# Copyright (c) 2023 Acme CPU
# Blower motor A102 configurations

config BLOWER_MOTOR_A102_MVOLTS_MIN
	int "Minimum voltage in mV for Blower Motor A102"
	range 10000 14000
	default 12000
	help
		The minimum voltage at which blower motor A102 can function
		
config BLOWER_MOTOR_A102_MVOLTS_MAX
	int "Maximum voltage in mV for Blower Motor A102"
	range 12000 24000
	default 24000
	help
		The maximum voltage at which blower motor A102 can function 
		
config BLOWER_MOTOR_A102_SPEED_RPM_MIN
	int "Minimum speed in RPM for Blower Motor A102"
	range 10000 20000
	default 10000
	help
		Minimum speed in RPM for Blower Motor A102
	
config BLOWER_MOTOR_A102_SPEED_RPM_MAX
	int "Maximum speed in RPM for Blower Motor A102"
	range 20000 45000
	default 45000
	help
		Maximum speed in RPM for Blower Motor A102
	
```

## c201_stm32g4/source/src/app/app_blower/Kconfig.blowera2
```kconfig
# Copyright (c) 2021 Acme CPU
# Blower motor A2 configurations

config BLOWER_MOTOR_A2_MVOLTS_MIN
	int "Minimum voltage in mV for Blower Motor A2"
	range 3000 10000
	default 8250
	help
		The minimum voltage at which blower motor A2 can function
		
config BLOWER_MOTOR_A2_MVOLTS_MAX
	int "Maximum voltage in mV for Blower Motor A2"
	range 12000 24000
	default 20000
	help
		The maximum voltage at which blower motor A2 can function 
```

## c201_stm32g4/source/src/app/app_blower/Kconfig.part
```kconfig
# Copyright (c) 2021 Acme CPU
# Choice of blower part used for the application

choice
	prompt "ACPU C201 Blower Selection"
	default BLOWER_MOTOR_A101

config BLOWER_MOTOR_A101
	bool "Blower Motor A101"
	help
	  Use the 3 phase BLDC Motor A101 as the blower to be used in the application
	  Selecting this will enable the particular driver to be used with this motor

config BLOWER_MOTOR_A102
	bool "Blower Motor A102"
	help
	  Use the 3 phase BLDC Motor A102 as the blower to be used in the application
	  Selecting this will enable the particular driver to be used with this motor 

config BLOWER_MOTOR_A2
	bool "Blower Motor A2"
	help
	  Use the 3 phase BLDC Motor A2 as the blower to be used in the application
	  Selecting this will enable the particular driver to be used with this motor 

endchoice


if BLOWER_MOTOR_A2
	rsource "Kconfig.blowera2"
endif # BLOWER_MOTOR_A2

if BLOWER_MOTOR_A101
	rsource "Kconfig.blowera101"
endif # BLOWER_MOTOR_A101

if BLOWER_MOTOR_A102
	rsource "Kconfig.blowera102"
endif # BLOWER_MOTOR_A102
```

## c201_stm32g4/source/src/app/app_data_recorder/Kconfig
```kconfig
# Copyright (c) 2021 Acme CPU
# Data Recorder configuration options

menuconfig APP_DATA_RECORDER
#	bool
	bool "Application Data Recorder Configurations"
	default n
#	depends on DISK_ACCESS_SDHC(=y) && CONFIG_FS_FATFS_LFN(=y)
	help
	  Enable or disable the Application Data Recorder.
	  The application saves pre-formatted data in the SD Card

if APP_DATA_RECORDER

config APP_DATA_RECORDER_MAX_CURR_FILESIZE_MB
	int "Current data file maximum size in Mbytes"
	range 1 1000
	default 10
	help
	    Current data file maximum size in Mbytes. If this size is reached, then the current file is
	    renamed with timestamp, and a new current file is opened for writing

config APP_DATA_RECORDER_MAX_FILE_COUNT
	int "Max number of data files that can exist"
	range 1 100
	default 10
	help
	    The maximum number of files that can exist in the data directory. Once the max file count is reached
	    the oldest file is deleted.

endif # APP_DATA_RECORDER
```

## c201_stm32g4/source/src/app/app_devcmd/Kconfig
```kconfig
# Copyright (c) 2021 Acme CPU
# Device commands application configurations 

menuconfig APP_DEVCMD
#	bool
	bool "Device commands application configurations"
	default n
	help
	  Device commands application configurations

if APP_DEVCMD

endif # APP_DEVCMD
```

## c201_stm32g4/source/src/app/app_dfu/Kconfig
```kconfig
# Copyright (c) 2024 Acme CPU
# Author: Rohan Dey (rohan@acmecpu.com)
# Device Firmware Upgrade 

menuconfig APP_DFU
	bool "Application level DFU configs"
	default n
	help
	  Enable / disable Application level DFU configs

if APP_DFU

config FW_DIR_NAME
	string "Firmware download directory name" 
	default "fw"
	help
	  Firmware download directory name 

config FW_FILE_MAX_FILE_COUNT
	int "File count for each firmware (this should be set to 1 only, don't change)"
	default 1
	help
	  File count for each firmware (this should be set to 1 only, don't change)

rsource "Kconfig.fwinfo"
rsource "Kconfig.stm32bl"

endif # APP_DFU
```

## c201_stm32g4/source/src/app/app_dfu/Kconfig.fwinfo
```kconfig
# Copyright (c) 2024 Acme CPU
# Author: Rohan Dey (rohan@acmecpu.com)
# Device Firmware Upgrade 

# Main firmware
config FW_MAIN_FILE_NAME
	string "File name for the app processor"
	default "main.bin"
	help
	  File name for the app processor

config FW_MAIN_FILE_MAX_KB
	int "Max file size in KB for app processor firmware"
	default 896
	help
	  Max file size in KB for app processor firmware


# Network firmware
config FW_NET_FILE_NAME
	string "File name for the network processor"
	default "net.bin"
	help
	  File name for the network processor 

config FW_NET_FILE_MAX_KB
	int "Max file size in KB for network processor firmware"
	default 8192
	help
	  Max file size in KB for network processor firmware


# BLDC driver firmware
config FW_BLWDRV_FILE_NAME
	string "File name for the bldc driver co-processor"
	default "blwdrv.bin"
	help
	  File name for the bldc driver co-processor

config FW_BLWDRV_FILE_MAX_KB
	int "Max file size in KB for bldc driver co-processor firmware"
	default 64
	help
	  Max file size in KB for bldc driver co-processor firmware
```

## c201_stm32g4/source/src/app/app_dfu/Kconfig.stm32bl
```kconfig
# Copyright (c) 2024 Acme CPU
# Author: Rohan Dey (rohan@acmecpu.com)
# Device Firmware Upgrade STM32 Bootloader Host config 


config STM32BL_UART_BAUD
	int "Baud rate for STM32 co-processor communication in bootloader mode"
	default 19200
	help
	  Baud rate for STM32 co-processor communication in bootloader mode

config STM32BL_UART_RX_BUFFER_SIZE
	int "Size of UART rx buffer in bytes"
	default 512
	help
	  Size of UART rx buffer in bytes
```

## c201_stm32g4/source/src/app/app_display/Kconfig
```kconfig
# Copyright (c) 2021 Acme CPU
# Display application configurations 

menuconfig APP_DISPLAY
	bool "App Display Configurations"
	default y
	help
	  Display application level configurations
	  
if APP_DISPLAY

#module = APP_DISPLAY
#module-str = app_display
#source "subsys/logging/Kconfig.template.log_config"

config C20X_SCREENS_TFT
	bool
	default n
	help
	  Enable/disable C20x TFT Display screens

config C20X_SCREENS_OLED
	bool
	default n
	help
	  Enable/disable C20x OLED Display screens
	  
rsource "Kconfig.displaytype"

config APP_DISPLAY_BRIGHTNESS_LEVEL
	int "Display default brightness in percentage"
	range 1 100
	default 100
	help
		Display default brightness in percentage

config APP_DISPLAY_DIMMED_LEVEL
	int "Brightness level as a percentage when dimmed due to no activity"
	range 1 100
	default 20
	help
		Brightness level as a percentage when dimmed due to no activity

config APP_DISPLAY_SLEEP_TM
	int "Display sleep time in seconds"
	range 1 100000
	default 30
	help
		Display sleep time in seconds

rsource "c20x_screens/Kconfig"

endif # APP_DISPLAY
```

## c201_stm32g4/source/src/app/app_display/Kconfig.displaytype
```kconfig
# Copyright (c) 2021 Acme CPU
# Choice of display used for the application

choice
	prompt "C20x Display Selection"
	default DISPLAY_TFT_2INCH

config DISPLAY_NONE
	bool "No display"
	help
	  Application does not use a display

config DISPLAY_TFT_1_5INCH
	bool "TFT Display 1.5 inch"
	select ST7789V
	select C20X_SCREENS_TFT
	help
	  Use 1.5 inch TFT display for the application

config DISPLAY_TFT_2INCH
	bool "TFT Display 2 inch"
	select ST7789V
	select C20X_SCREENS_TFT
	help
	  Use 2 inch TFT display for the application

config DISPLAY_OLED_0_96INCH
	bool "OLED Display 0.96 inch"
	select SSD1306
	select C20X_SCREENS_OLED
	help
	  Use 0.96 inch OLED display for the application

endchoice

if DISPLAY_TFT_2INCH
	rsource "Kconfig.tft"
endif # DISPLAY_TFT_2INCH

if DISPLAY_TFT_1_5INCH
	rsource "Kconfig.tft"
endif # DISPLAY_TFT_1_5INCH

if DISPLAY_OLED_0_96INCH
	rsource "Kconfig.oled"
endif # DISPLAY_OLED_0_96INCH
```

## c201_stm32g4/source/src/app/app_display/Kconfig.oled
```kconfig
# Copyright (c) 2021 Acme CPU
# OLED display configurations


config APP_DISPLAY_HEIGHT_PX
	int "Display height in pixels"
	range 1 4000
	default 64
	help
		Display height in pixels
		
config APP_DISPLAY_WIDTH_PX
	int "Display width in pixels"
	range 1 4000
	default 128
	help
		Display width in pixels
		
config APP_DISPLAY_STATUSBAR_HEIGHT_PX
	int "Statusbar height in pixels"
	range 1 4000
	default 10
	help
		Display width in pixels
		
```

## c201_stm32g4/source/src/app/app_display/Kconfig.tft
```kconfig
# Copyright (c) 2021 Acme CPU
# TFT display configurations


config APP_DISPLAY_HEIGHT_PX
	int "Display height in pixels"
	range 1 4000
	default 240
	help
		Display height in pixels
		
config APP_DISPLAY_WIDTH_PX
	int "Display width in pixels"
	range 1 4000
	default 320
	help
		Display width in pixels
		
config APP_DISPLAY_DIMMING_SUPPORT
	bool "Supports display dimming"
	default y
	help
		Supports display dimming

config APP_DISPLAY_STATUSBAR_HEIGHT_PX
	int "Statusbar height in pixels"
	range 1 4000
	default 24
	help
		Display width in pixels
	
```

## c201_stm32g4/source/src/app/app_display/c20x_screens/Kconfig
```kconfig
# Copyright (c) 2023 Acme CPU
# C20x screen configurations 

menuconfig C20X_SCREENS
	bool "C20x screen configurations"
	default y
	help
	  C20x screen configurations
	  
if C20X_SCREENS

module = C20X_SCREENS
module-str = c20x_screens
source "subsys/logging/Kconfig.template.log_config"

endif # C20X_SCREENS
```

## c201_stm32g4/source/src/app/app_fluid_level/Kconfig
```kconfig
# Copyright (c) 2024 Acme CPU
# Application fluid level configuration option

config APP_HAS_FLUID_LEVEL
	bool "Application fluid level configurations"
	default n
	help
	  Enable or disable the fluid_level
```

## c201_stm32g4/source/src/app/app_heater/Kconfig
```kconfig
# Copyright (c) 2021 Acme CPU
# Heater configuration options

config APP_HAS_HEATER
	bool "App Heater Configurations"
	default n
	help
	  Enable or disable the Heater

#if APP_HAS_HEATER
rsource "Kconfig.heater24W"
rsource "Kconfig.heater12W"
#endif
```
