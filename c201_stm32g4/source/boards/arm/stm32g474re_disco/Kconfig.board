## c201_stm32g4/source/boards/arm/stm32g474re_disco/Kconfig.board
```kconfig
# STM32G474RE Discovery board configuration

# Copyright (c) 2019 STMicroelectronics.
# SPDX-License-Identifier: Apache-2.0

config BOARD_G474RE_DISCO
	bool "Discovery G474RE Development Board"
	depends on SOC_STM32G474XX
```

## c201_stm32g4/source/boards/arm/stm32g474re_disco/Kconfig.defconfig
```kconfig
# STM32G474RE Discovery board configuration

# Copyright (c) 2019 STMicroelectronics.
# SPDX-License-Identifier: Apache-2.0

if BOARD_G474RE_DISCO

config BOARD
	default "stm32g474re_disco"

#config SPI_STM32_INTERRUPT
#	default y
#	depends on SPI

endif # BOARD_G474RE_DISCO
```

## c201_stm32g4/source/modules/Kconfig
```kconfig
# Copyright (c) 2021 Acme CPU

rsource "bq25611d/Kconfig"
rsource "bsp_leds/Kconfig"
rsource "bsp-drv/Kconfig"
#rsource "gpio/Kconfig"
rsource "pca9545/Kconfig"
rsource "pca9632/Kconfig"
rsource "pcal9539a/Kconfig"
rsource "tim_ic/Kconfig"
rsource "drv10975/Kconfig"
rsource "stspin220/Kconfig"
rsource "tps55340/Kconfig"
rsource "buzzer_generic/Kconfig"
rsource "microcrystal_rv3028/Kconfig"
rsource "ts3usbca4/Kconfig"
rsource "tps22810/Kconfig"
rsource "stm32_option_bytes/Kconfig"
rsource "stm32g4_ucpd/Kconfig"
rsource "tps61169/Kconfig"
rsource "bma253/Kconfig"
rsource "ltc294x/Kconfig"
rsource "bq25890/Kconfig"
rsource "bq25792/Kconfig"
rsource "cmx655d/Kconfig"
rsource "power_control_driver/Kconfig"
rsource "stusb4500/Kconfig"
```

## c201_stm32g4/source/modules/Kconfig.dma.stm32
```kconfig
# DMA configuration options

# Copyright (c) 2016 Intel Corporation
# Copyright (c) 2019 Song Qiang <songqiang1304521@gmail.com>
# SPDX-License-Identifier: Apache-2.0

config DMA_STM32
	bool "Enable STM32 DMA driver"
	select USE_STM32_LL_DMA
	depends on SOC_FAMILY_STM32
	help
	  DMA driver for STM32 series SoCs.

if DMA_STM32

config DMA_STM32_V1
	bool
	depends on SOC_SERIES_STM32F2X || SOC_SERIES_STM32F4X || SOC_SERIES_STM32F7X
	help
	  Enable DMA support on F2/F4/F7 series SoCs.

config DMA_STM32_V2
	bool "Enable STM32 DMA V2 Driver"
	depends on SOC_SERIES_STM32F0X || SOC_SERIES_STM32F1X || SOC_SERIES_STM32F3X || SOC_SERIES_STM32G4X || SOC_SERIES_STM32L0X || SOC_SERIES_STM32L4X || SOC_SERIES_STM32WBX
	help
	  Enable DMA support on F0/F1/F3/G4/L0/L4/WB series SoCs.

config DMAMUX_STM32
	bool "Enable STM32 DMAMUX Driver"
	depends on DMA_STM32_V2
	depends on SOC_STM32L4R5XX || SOC_SERIES_STM32G4X || SOC_SERIES_STM32WBX
	help
	  Enable DMAMUX support on G4/L4R/WB series SoCs.

config DMA_STM32_SHARED_IRQS
	bool
	default y
	depends on SOC_SERIES_STM32F0X || SOC_SERIES_STM32L0X
	help
	  Enable shared IRQ support on devices where channels share 1 IRQ.

endif # DMA_STM32
```

## c201_stm32g4/source/modules/bq25890/Kconfig
```kconfig
# Copyright (c) 2022 Acme CPU
# BQ25890 Single cell I2C Battery Charger configurations

menuconfig BQ25890
	bool "BQ25890 I2C Battery Charger"
	depends on I2C
	help
	  Enable driver for BQ25890 Single cell I2C Battery Charger

if BQ25890

module = BQ25890
module-str = bq25890
source "subsys/logging/Kconfig.template.log_config"

config BQ25890_INIT_PRIORITY
	int "Init Priority"
	default APPLICATION_INIT_PRIORITY
	help
	    Device driver initialization priority.

endif # BQ25890
```

## c201_stm32g4/source/modules/bsp-drv/Kconfig
```kconfig
# Copyright (c) 2021 Acme CPU
# BSP GPIO Driver configuration options

menuconfig BSP_GPIO_DRIVER
	bool "Enable Acme CPU BSP Driver"
	default n
	help
	    Enables Acme CPU C201 Board Support Package Driver

if BSP_GPIO_DRIVER

module = BSP_GPIO_DRIVER
module-str = bsp_gpio_driver
source "subsys/logging/Kconfig.template.log_config"

config BSP_GPIO_DRIVER_INIT_PRIORITY
	int
	default 80
	help
	    Board Support Package GPIO Driver Initialization Priority

endif # BSP_GPIO_DRIVER
```

## c201_stm32g4/source/modules/bsp_leds/Kconfig
```kconfig
# Copyright (c) 2021 Acme CPU

menuconfig BSP_LEDS
	bool "BSP LED module"
	help
	  Enable BSP LED module
	  
if BSP_LEDS

module = BSP_LEDS
module-str = bsp_leds
source "subsys/logging/Kconfig.template.log_config"

config BSP_LEDS_INIT_PRIORITY
	int "BSP_LEDS initialization priority"
	default 90
	help
	  System initialization priority for BSP_LEDS module.

endif # BSP_LEDS
```

## c201_stm32g4/source/modules/drv10975/Kconfig
```kconfig
# DRV10975 I2C Motor Driver configurations
# Copyright (c) 2021 Acme CPU

menuconfig DRV10975
	bool "DRV10975 I2C Motor Driver"
#	depends on I2C_MGM_PCA95XX
	depends on I2C
	help
	  Enable driver for DRV10975 I2C Motor Driver

if DRV10975

module = DRV10975
module-str = drv10975
source "subsys/logging/Kconfig.template.log_config"

config DRV10975_INIT_PRIORITY
	int "Init Priority"
	default APPLICATION_INIT_PRIORITY
	help
	    Device driver initialization priority.

rsource "Kconfig.drv10975"

endif # DRV10975
```

## c201_stm32g4/source/modules/drv10975/Kconfig.drv10975
```kconfig
# DRV10975 I2C Motor Driver configurations

config DRV10975_MOTOR_PARAMS1
	hex
	default 0x48

config DRV10975_MOTOR_PARAMS2
	hex
	default 0x01

config DRV10975_MOTOR_PARAMS3
	hex
	default 0x07
	
config DRV10975_SYSTEM_OPTION1
	hex
	default 0x00

config DRV10975_SYSTEM_OPTION2
	hex
	default 0x80
	
config DRV10975_SYSTEM_OPTION3
	hex
	default 0x38
	
config DRV10975_SYSTEM_OPTION4
	hex
	default 0xf9
	
config DRV10975_SYSTEM_OPTION5
	hex
	default 0x00
	
config DRV10975_SYSTEM_OPTION6
	hex
	default 0x99
	
config DRV10975_SYSTEM_OPTION7
	hex
	default 0x78

config DRV10975_SYSTEM_OPTION8
	hex
	default 0x00

config DRV10975_SYSTEM_OPTION9
	hex
	default 0x0d
	
```

## c201_stm32g4/source/modules/gpio/Kconfig
```kconfig
# GPIO configuration options

# Copyright (c) 2021 Acme CPU
# SPDX-License-Identifier: Apache-2.0

if GPIO

rsource "Kconfig.pca95xx"

endif # GPIO
```

## c201_stm32g4/source/modules/gpio/Kconfig.pca95xx
```kconfig
# PCA95XX GPIO configuration options

# Copyright (c) 2016 Intel Corporation
# SPDX-License-Identifier: Apache-2.0

config GPIO_PCA95XX_INT_EXT
	bool "Extension to the PCA95XX I2C-based GPIO chip driver"
	depends on I2C
	help
	  Enable interrupt extension driver for PCA95XX I2C-based GPIO chip.

config GPIO_PCA95XX_INT_EXT_INIT_PRIORITY
	int "Init priority"
	default 71
	depends on GPIO_PCA95XX_INT_EXT
	help
	  Device driver initialization priority.
	  
```

## c201_stm32g4/source/modules/pca9545/Kconfig
```kconfig
# PCA9545 I2C Bus Multiplexer configuration options
# Copyright (c) 2021 Acme CPU
# SPDX-License-Identifier: Apache-2.0

menuconfig I2C_MGM_PCA95XX
	bool "PCA9545 I2C Bus Multiplexer"
#	depends on I2C_DMA
	depends on I2C
	help
	  Enable driver for PCA9545 I2C Bus Multiplexer.

if I2C_MGM_PCA95XX

module = I2C_MGM
module-str = i2c_mgm
source "subsys/logging/Kconfig.template.log_config"

config I2C_MGM_PCA95XX_INIT_PRIORITY
	int "I2C MGM Init Priority"
	default 64
	help
	    Sets up the device driver initialization priority

config I2C_MGM_PCA95XX_CH_INIT_PRIORITY
	int "I2C MGM Channel Init Priority"
	#default 65
	default 85
	help
	    Sets up the device driver initialization priority

config I2C_MGM_PCA95XX_INTERRUPT
        bool "Interrupt enable"
        default n
        depends on I2C_MGM_PCA95XX
        help
          Enable interrupt support in I2C_MGM_PCA95XX driver.

endif # PCA9545
```

## c201_stm32g4/source/modules/pca9632/Kconfig
```kconfig
# Copyright (c) 2021 Acme CPU

# Top-level configuration file for LED drivers.

menuconfig PCA9632
	bool "PCA9632 LED driver"
#	depends on I2C_MGM_PCA95XX
	depends on I2C
	help
	  Enable LED driver for PCA9632.

	  PCA9632 LED driver has 4 channels each with multi-programmable
	  states. Each channel can drive up to 25 mA per LED.
	  
if PCA9632

module = PCA9632
module-str = pca9632
source "subsys/logging/Kconfig.template.log_config"

config PCA9632_INIT_PRIORITY
	int "PCA9632 initialization priority"
	default 90
	help
	  System initialization priority for LED drivers.

endif # PCA9632
```

## c201_stm32g4/source/modules/stm32_option_bytes/Kconfig
```kconfig
# Copyright (c) 2021 Acme CPU
# STM32 Flash Option Bytes driver configurations

menuconfig STM32_OPTION_BYTES_DRIVER
	bool "STM32 Option Bytes read write driver"
	default n
	select USE_STM32_HAL_FLASH
	select USE_STM32_HAL_FLASH_EX
	help
	  Enable STM32 Option Bytes read write driver

if STM32_OPTION_BYTES_DRIVER

module = STM32_OPTION_BYTES_DRIVER
module-str = stm32_ob_drv
source "subsys/logging/Kconfig.template.log_config"

config STM32_OB_DRIVER_INIT_PRIORITY
	int "Init Priority"
	default APPLICATION_INIT_PRIORITY
	help
	    Device driver initialization priority.

endif # STM32_OPTION_BYTES_DRIVER
```

## c201_stm32g4/source/modules/stspin220/Kconfig
```kconfig
# STSPIN220 Stepper Motor Driver configurations
# Copyright (c) 2021 Acme CPU

menuconfig STSPIN220
	bool "STSPIN220 Stepper Motor Driver"
	help
	  Enable driver for STSPIN220 Stepper Motor Driver

if STSPIN220

module = STSPIN220
module-str = stspin220
source "subsys/logging/Kconfig.template.log_config"

config STSPIN220_INIT_PRIORITY
	int "Init Priority"
	default APPLICATION_INIT_PRIORITY
	help
	    Device driver initialization priority.

rsource "Kconfig.stspin220"

endif # STSPIN220
```

## c201_stm32g4/source/modules/tim_ic/Kconfig
```kconfig
# Copyright (c) 2021 Acme CPU
# TIM IC configuration options

menuconfig TIM_IC
	bool "Timer Input Capture Drivers"
	help
	  Enable config options for TIM IC drivers.

if TIM_IC

module = TIM_IC
module-str = tim_ic
source "subsys/logging/Kconfig.template.log_config"

rsource "Kconfig.stm32"

endif # TIM_IC
```

## c201_stm32g4/source/modules/tim_ic/Kconfig.stm32
```kconfig
# STM32 TIM IC configuration options

# Copyright (c) 2021 Acme CPU
# SPDX-License-Identifier: Apache-2.0

config TIM_IC_STM32
	bool "STM32 MCU TIM IC driver"
	depends on SOC_FAMILY_STM32
	select USE_STM32_LL_TIM
	select USE_STM32_LL_RCC if SOC_SERIES_STM32F4X || SOC_SERIES_STM32F7X || SOC_SERIES_STM32H7X
	help
	  This option enables the TIM IC driver for STM32 family of
	  processors. Say y if you wish to use TIM IC port on STM32
	  MCU.
```

## c201_stm32g4/source/modules/tps22810/Kconfig
```kconfig
# Copyright (c) 2021 Acme CPU

menuconfig TPS22810
	bool "TPS22810 18V 3A Load Switch"
	help
	  Enable TPS22810 18V 3A Load Switch
	  
if TPS22810

module = TPS22810
module-str = tps22810
source "subsys/logging/Kconfig.template.log_config"

config TPS22810_INIT_PRIORITY
	int "TPS22810 initialization priority"
#	default 69
	default 89
	help
	  TPS22810 initialization priority

endif # TPS22810
```

## c201_stm32g4/source/modules/tps55340/Kconfig
```kconfig
# TPS55340 boost converter configurations
# Copyright (c) 2021 Acme CPU

menuconfig TPS55340
	bool "TPS55340 boost converter configurations"
	default n
	help
	  Enable driver for TPS55340 boost converter configurations

if TPS55340

module = TPS55340
module-str = tps55340
source "subsys/logging/Kconfig.template.log_config"

config TPS55340_INIT_PRIORITY
	int "Init Priority"
	default APPLICATION_INIT_PRIORITY
#	default 69
	help
	    Device driver initialization priority.

endif # TPS55340
```

## c201_stm32g4/source/modules/tps61169/Kconfig
```kconfig
# Generic buzzer configurations
# Copyright (c) 2021 Acme CPU

menuconfig TPS61169
	bool "TPS61169 sepic led driver"
	help
	  Enable driver for TPS61169 sepic led driver

if TPS61169

module = TPS61169
module-str = tps61169
source "subsys/logging/Kconfig.template.log_config"

config TPS61169_INIT_PRIORITY
	int "Init Priority"
	default APPLICATION_INIT_PRIORITY
	help
	    Device driver initialization priority.

endif # TPS61169
```

## c201_stm32g4/source/modules/ts3usbca4/Kconfig
```kconfig
# Copyright (c) 2021 Acme CPU

# Top-level configuration file for LED drivers.

menuconfig TS3USBCA4
	bool "TS3USBCA4 USB C SBU MUX driver"
#	depends on I2C_MGM_PCA95XX
	depends on I2C
	help
	  Enable TS3USBCA4 USB C SBU MUX driver
	  
if TS3USBCA4

module = TS3USBCA4
module-str = ts3usbca4
source "subsys/logging/Kconfig.template.log_config"

config TS3USBCA4_INIT_PRIORITY
	int "TS3USBCA4 initialization priority"
	default APPLICATION_INIT_PRIORITY
	help
	  System initialization priority

endif # TS3USBCA4
```
