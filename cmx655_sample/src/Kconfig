## cmx655_sample/src/Kconfig
```kconfig
# Copyright (c) 2023 Acme CPU

menu "CMX655D Application Configurations"

rsource "app/Kconfig"
#rsource "bsp/Kconfig"
rsource "lib/Kconfig"

endmenu
```

## cmx655d/Kconfig
```kconfig
# Copyright (c) 2022 Acme CPU
# CMX655D audio codec configurations

menuconfig CMX655D
	bool "CMX655D audio codec"
	depends on I2C
	help
	  Enable driver for CMX655D audio codec

if CMX655D

module = CMX655D
module-str = cmx655d
source "subsys/logging/Kconfig.template.log_config"

config CMX655D_INIT_PRIORITY
	int "CMX655D Init Priority"
	default APPLICATION_INIT_PRIORITY
	help
	    Device driver initialization priority.

config CMX655D_INTERRUPT
	bool "Interrupt enable"
	default n
	depends on CMX655D
	help
	  Enable interrupt support in CMX655D driver.

endif # CMX655D
```

## h20x_nrf5x/h20x_nrf5x/boards/arm/h205c_nrf5340/Kconfig.board
```kconfig
# H205C NRF5340 board configuration

# Copyright (c) 2019-2020 Nordic Semiconductor ASA
# SPDX-License-Identifier: Apache-2.0

if SOC_NRF5340_CPUAPP_QKAA

config BOARD_H205C_NRF5340_CPUAPP
	bool "H205C nRF5340 Application MCU"

config BOARD_H205C_NRF5340_CPUAPP_NS
	bool "H205C nRF5340 Application MCU non-secure"

endif # SOC_NRF5340_CPUAPP_QKAA

config BOARD_H205C_NRF5340_CPUNET
	bool "H205C NRF5340 Network MCU"
	depends on SOC_NRF5340_CPUNET_QKAA
```

## h20x_nrf5x/h20x_nrf5x/modules/Kconfig
```kconfig
# Copyright (c) 2021 Acme CPU

rsource "bq25611d/Kconfig"
rsource "pcal9539a/Kconfig"
rsource "buzzer_generic/Kconfig"
rsource "cmx655d/Kconfig"
rsource "h205c_power/Kconfig"
rsource "max30001/Kconfig"
rsource "ltc294x/Kconfig"
rsource "shmax30101/Kconfig"
```

## h20x_nrf5x/h20x_nrf5x/modules/h205c_power/Kconfig
```kconfig
# Copyright (c) 2022 Acme CPU
# H205C power control driver configurations

menuconfig H205C_POWER
	bool "H205C power control driver"
	default n
	help
	  Enable driver H205C board power.
	  This will enable / disable various power ICs on the H205C board at boot time based on dts configurations
	  The drver also exposes APIs to control the power ICs from the application

if H205C_POWER

module = H205C_POWER
module-str = h205c_power
source "subsys/logging/Kconfig.template.log_config"

config H205C_POWER_INIT_PRIORITY
	int "H205C_POWER Init Priority"
	default 67
	help
	    Device driver initialization priority.

endif # H205C_POWER
```

## h20x_nrf5x/h20x_nrf5x/src/Kconfig
```kconfig
# Copyright (c) 2022 Acme CPU

menu "ACPU H20X Application Configurations"

rsource "app/Kconfig"
#rsource "bsp/Kconfig"
rsource "lib/Kconfig"

endmenu
```

## h20x_nrf5x/h20x_nrf5x/src/app/Kconfig
```kconfig
# Copyright (c) 2022 Acme CPU

rsource "app_utils/Kconfig"
rsource "app_audio/Kconfig"
rsource "app_storage/Kconfig"
rsource "app_shellcmd/Kconfig"
rsource "app_sensor/Kconfig"
rsource "app_analog/Kconfig"
rsource "app_uart/Kconfig"
rsource "app_haptic/Kconfig"
rsource "app_battery/Kconfig"
rsource "app_push_switch/Kconfig"
```

## h20x_nrf5x/h20x_nrf5x/src/app/app_analog/Kconfig
```kconfig
# Copyright (c) 2022 Acme CPU
# Sensors application configurations 

menuconfig APP_ANALOG
	bool "ADC configurations"
	default y
	help
	  Enable / disable ADC measurement module

if APP_ANALOG

config APP_ANALOG_VBAT_R1
	int "VBAT resistor divider R1 in ohms"
	default 2700
	help
	  VBAT resistor divider R1 in ohms

config APP_ANALOG_VBAT_R2
	int "VBAT resistor divider R2 in ohms"
	default 7500
	help
	  VBAT resistor divider R2 in ohms

config APP_ANALOG_VBUS_R1
	int "VBUS resistor divider R1 in ohms"
	default 4700
	help
	  VBUS resistor divider R1 in ohms

config APP_ANALOG_VBUS_R2
	int "VBUS resistor divider R2 in ohms"
	default 7500
	help
	  VBUS resistor divider R2 in ohms

endif # APP_SENSOR
```

## h20x_nrf5x/h20x_nrf5x/src/app/app_battery/Kconfig
```kconfig
# Copyright (c) 2022 Acme CPU
# Battery application configurations 

menuconfig APP_BATTERY
	bool "Device Battery configurations"
	default y
	help
	  Device battery configurations
	  
if APP_BATTERY

config APP_BATTERY_MIN_VALUE_MVOLTS
	int "Battery minimmum value in mili volts"
	default 3000
	help
	  Battery minimmum value in mili volts. This is value at which the  
	  battery level should be 0% 

config APP_BATTERY_MAX_VALUE_MVOLTS
	int "Battery maximum value in mili volts"
	default 4200
	help
	  Battery maximum value in mili volts. This is value at which the  
	  battery level should be 100%

config APP_BATTERY_VALUE_NORMALIZE_COUNT
	int "Acquired battery value averaging count"
	default 80
	help
		The number of time the battery voltage should be averaged
		so that there is less or no fluctuations in the reading

config APP_BATTERY_CHARGE_CURRENT_LIMIT
	int "Battery charging current limit in mA"
	range 500 5000
	default 1500
	help
		The battery charging current limit to be set into the battery charger chip.
		This is based on the type of battery attached to the application

config APP_BATTERY_CHARGER_INPUT_CURRENT_LIMIT
	int "Charger input current limit in mA"
	range 100 5000
	default 500
	help
		The battery charger input current limit to be set into the battery charger chip.
		This is based on the type of battery attached to the application

config APP_BATTERY_CHARGE_CURRENT_MAX
	int "Battery charging current maximum mA"
	range 500 5000
	default 3000
	help
		The maximum battery charging current possible

config APP_BATTERY_CHARGER_INPUT_CURRENT_MAX
	int "Charger input current limit in mA"
	range 100 5000
	default 3000
	help
		The maximum input charging current possible		

config APP_BATTERY_MAX_CAPACITY_MAH
	int "Maximum battery capacity in mah"
	range 100 20000
	default 5000
	help
		Maximum battery capacity in mah
				
endif # APP_BATTERY
```

## h20x_nrf5x/h20x_nrf5x/src/app/app_haptic/Kconfig
```kconfig
# Copyright (c) 2022 Acme CPU
# Haptic feedback configurations 

menuconfig APP_HAPTIC_FB
	bool "Haptic feedback configurations"
	default y
	help
	  Enable / disable Haptic feedback

if APP_HAPTIC_FB

choice
	prompt "Haptic feedback actuator drive"
	default APP_HAPTIC_FB_DRIVE_GPIO

	config APP_HAPTIC_FB_DRIVE_PWM
		bool "The haptic feedback actuator is driven by PWM"
		help
			The haptic feedback actuator is driven by PWM

	config APP_HAPTIC_FB_DRIVE_GPIO
		bool "The haptic feedback actuator is driven by GPIO"
		help
			The haptic feedback actuator is driven by GPIO
endchoice

endif # APP_HAPTIC_FB
```

## h20x_nrf5x/h20x_nrf5x/src/app/app_push_switch/Kconfig
```kconfig
# Copyright (c) 2022 Acme CPU
# App push switch configurations

menuconfig APP_PUSH_SWITCH
	bool "App push switch configurations"
	default y
	help
	  Enable / disable App push switch
```

## h20x_nrf5x/h20x_nrf5x/src/app/app_shellcmd/Kconfig
```kconfig
# Copyright (c) 2021 Acme CPU
# Shell commands application configurations 

menuconfig APP_SHELLCMD
	bool "Shell commands"
	default y
	depends on SHELL
	help
	  Enable / disable shell commands

if APP_SHELLCMD

endif # APP_SHELLCMD
```

## h20x_nrf5x/h20x_nrf5x/src/app/app_uart/Kconfig
```kconfig
# Copyright (c) 2022 Acme CPU
# UART application configurations 

menuconfig APP_UART
	bool "UART m2m configurations"
	default y
	help
	  Enable / disable UART m2m

if APP_UART


endif # APP_UART
```

## h20x_nrf5x/h20x_nrf5x/src/lib/Kconfig
```kconfig
# Copyright (c) 2022 Acme CPU

rsource "lib_push_switch/Kconfig"
rsource "lib_audio/Kconfig"
```

## lib_audio/Kconfig
```kconfig
# Copyright (c) 2023 Acme CPU
# Configurations for audio library

menuconfig LIB_AUDIO
    bool "Audio library"
    default n
    help
      Enable or disable audio library to be used in the application

if LIB_AUDIO
    # select audio codec
    choice
        prompt "Audio Codec Selection"
        default LIB_AUDIO_CODEC_CMX655D

    config LIB_AUDIO_CODEC_CMX655D
        bool "CMX655D voice codec"
        select CMX655D
        help
            Use the cmx655d voice codec to be used in the application, selecting this will enable the particular driver to be used with this motor 

    config LIB_AUDIO_CODEC_NONE
        bool "No audio codec"
        help
            No audio codec used
    endchoice

    # sampling rate
    config LIB_AUDIO_SAMPLE_RATE
        int "sampling rate"
        default 8000
        help
            sampling rate in samples per second

    # number of channels
    config LIB_AUDIO_NUM_CHANNEL
        int "number of channels"
        range 1 2
        default 2
        help
            number of channels (1 - mono, 2 - stereo)

    # bits per sample
    config LIB_AUDIO_BPS
        int "bits per sample"
        default 16
        help
            bits per sample

    # maximum file size for recording in KB
    config LIB_AUDIO_MAX_REC_FILE_SIZE_KB
        int "maximum file size for recording in KB"
        range 1 1000000
        default 1000
        help
            maximum file size for recording in KB

endif # LIB_AUDIO
```

## lib_file_oper/Kconfig
```kconfig
# Copyright (c) 2023 Acme CPU
# Configurations for file operations library 

menuconfig LIB_FILE_OPER
	bool "File operations library"
	default y
	help
	  Enable or disable the file operations library to be used in the application 

if LIB_FILE_OPER

config LIB_FILE_OPER_MAX_FILES
	int "Max number of files that can be created / opened"
	default 1
	help
		Max number of files that can be created / opened		

config LIB_FILE_OPER_FILE_PATH_LEN_MAX
	int "Max file path length in bytes"
	default 100
	help
		Max file path length in bytes		

config LIB_THREAD_STACK_SIZE_FILE_OPER
	int "Lib file thread stack size in bytes"
	default 2048
	help
		Lib file thread stack size in bytes		

config LIB_THREAD_PRIO_FILE_OPER
	int "Lib file thread priority"
	default 10
	help
		Lib file thread priority		


endif # LIB_FILE_OPER
```

## lib_m2m_frame/Kconfig
```kconfig
# Copyright (c) 2024 Acme CPU
# Configurations for m2m frame library 

menuconfig LIB_M2M_FRAME
	bool "M2m frame library"
	default y
	help
	  Enable or disable the M2m frame library 

if LIB_M2M_FRAME
	config LIB_M2M_FRAME_BUFFER_SIZE_MAX
		int "Maximum size of the frame buffer used for transmission"
		range 32 102400
		default 512
		help
			Maximum size of the frame buffer used for transmission

	config LIB_M2M_FRAME_ACK_TIMEOUT_MS
		int "Timeout in ms for the sender to wait for acknowledgment before re-transmission"
		range 10 60000
		default 2000
		help
			Timeout in ms for the sender to wait for acknowledgment before re-transmission

	config LIB_M2M_FRAME_RETRY_COUNT_MAX
		int "Maximum number of times a packet re-transmission should be tried"
		range 1 1000
		default 10
		help
			Maximum number of times a packet re-transmission should be tried

endif # LIB_M2M_FRAME
```

## lib_matrix_keypad/Kconfig
```kconfig
# Copyright (c) 2023 Acme CPU
# Configurations for matrix keypad library 

menuconfig LIB_MATRIX_KEYPAD
	bool "Matrix Keypad library"
	default y
	help
	  Enable or disable the matrix keypad library 

if LIB_MATRIX_KEYPAD
	config MATRIX_KEYPAD_MAX_ROWS
		int "Maximum number of rows to be supported by the library"
		range 1 20
		default 4
		help
			Maximum number of rows to be supported by the library
	
	config MATRIX_KEYPAD_MAX_COLS
		int "Maximum number of columns to be supported by the library"
		range 1 20
		default 4
		help
			Maximum number of columns to be supported by the library

	choice
		prompt "Select whether row or column is output"
		default MATRIX_KEYPAD_COL_OUTPUT
	config MATRIX_KEYPAD_ROW_OUTPUT
		bool "Keypad rows are output"
		help
		  Keypad rows will be set as output and columns will be scanned
	config MATRIX_KEYPAD_COL_OUTPUT
		bool "Keypad cols are output"
		help
		  Keypad columns will be set as output and rows will be scanned
	endchoice
	
	choice
		prompt "Select whether drive signal is HIGH or LOW"
		default MATRIX_KEYPAD_OUTPUT_DRIVE_HIGH
	config MATRIX_KEYPAD_OUTPUT_DRIVE_HIGH
		bool "Drive signal will be high"
		help
		  Drive signal will be high
	config MATRIX_KEYPAD_OUTPUT_DRIVE_LOW
		bool "Drive signal will be low"
		help
		  Drive signal will be low
	endchoice
		
	config KEY_PRESS_DURATION_MS_MIN
		int "Minimum time in milli seconds a key must stay asserted for a normal press detection"
		range 50 500
		default 150
		help
		    A normal key press is considered valid if the time (in milli seconds) from the moment an interrupt is detected is
		    more than this time
	
	config KEY_PRESS_DURATION_MS_MAX
		int "Maximum time in milli seconds a key can stay asserted for normal press detection"
		range 100 2000
		default 800
		help
		    The maximum time helps to rule out incorrect data.

endif # LIB_MATRIX_KEYPAD
```

## lib_push_switch/Kconfig
```kconfig
# Copyright (c) 2022 Acme CPU
# Configurations for push switch library 

menuconfig LIB_PUSH_SWITCH
	bool "Push switch library"
	default y
	help
	  Enable or disable the Push switch library to be used in the application 

if LIB_PUSH_SWITCH

	config PUSH_SWITCH_MAX_COUNT
		int "Maxiumum number of push switches in the application"
		default 0
		help
			Maxiumum number of push switches in the application

config SWITCH_EDGE_NORMAL_PRESS_DURATION_MS_MIN
	int "(EDGE TRIG) Min time in milli seconds a switch must stay asserted for normal press detection"
	range 50 500
	default 150
	help
	    A normal switch press is considered valid if the time (in milli seconds) from the moment an interrupt is detected is
	    more than this time

config SWITCH_EDGE_LONG_PRESS_DURATION_MS_MIN
	int "(EDGE TRIG) Min time in milli seconds a switch must stay asserted for long press detection"
	range 2000 10000
	default 3000
	help
	    A long switch press is considered valid if the time (in milli seconds) from the moment an interrupt is detected is
	    more than this time

config SWITCH_LEVEL_NORMAL_PRESS_DURATION_MS_MIN
	int "(LEVEL TRIG) Min time in milli seconds a switch must stay asserted for normal press detection"
	range 50 500
	default 200
	help
	    A normal switch press is considered valid if the time (in milli seconds) from the moment an interrupt is detected is
	    more than this time

config SWITCH_LEVEL_NORMAL_PRESS_DURATION_MS_MAX
	int "(LEVEL TRIG) Max time in milli seconds a switch can stay asserted for normal press detection"
	range 500 2000
	default 800
	help
	    The maximum time helps to rule out incorrect data.

config SWITCH_ASSERTED_PHY_LEVEL
	int "The physical level of a pin which translates to a switch being pressed / asserted"
	range 0 1
	default 0
	help
	    Depending on this value, the library will return SWITCH_ASSERTED and SWITCH_DEASSERTED
	    states when lib_push_switch_state_get() is called

endif # LIB_PUSH_SWITCH
```

## ltc294x/Kconfig
```kconfig
# Copyright (c) 2022 Acme CPU
# LTC294x I2C Battery Gauge configurations

menuconfig LTC294X
	bool "LTC294X I2C Battery Gauge"
	depends on I2C
	help
	  Enable driver for LTC294X (LTC2941, LTC2942, LTC2943, LTC2944) I2C Battery Gauge

if LTC294X

module = LTC294X
module-str = ltc294x
source "subsys/logging/Kconfig.template.log_config"

config LTC294X_INIT_PRIORITY
	int "Init Priority"
	default APPLICATION_INIT_PRIORITY
	help
	    Device driver initialization priority.

endif # LTC294X
```

## max30001/Kconfig
```kconfig
# Copyright (c) 2022 Acme CPU
# MAX30001 audio codec configurations

menuconfig MAX30001
	bool "Maxim MAX30001 ECG & BioZ AFE"
	depends on SPI
	help
	  Enable driver for Maxim MAX30001 ECG & BioZ AFE

if MAX30001

module = MAX30001
module-str = max30001
source "subsys/logging/Kconfig.template.log_config"

config MAX30001_INIT_PRIORITY
	int "MAX30001 Init Priority"
	default APPLICATION_INIT_PRIORITY
	help
	    Device driver initialization priority.

config MAX30001_INTERRUPT_B
	bool "Interrupt B enable"
	default n
	depends on MAX30001
	help
	  Enable interrupt B support in MAX30001 driver.

config MAX30001_INTERRUPT_2B
	bool "Interrupt 2B enable"
	default n
	depends on MAX30001
	help
	  Enable interrupt 2B support in MAX30001 driver.

endif # MAX30001
```
