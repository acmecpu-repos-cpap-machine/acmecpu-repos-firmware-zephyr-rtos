## pcal9539a/Kconfig
```kconfig
# Copyright (c) 2021 Acme CPU
# PCAL9539A I2C based GPIO Expander

menuconfig GPIO_PCAL9539A
	bool "PCAL9539A I2C based GPIO Expander"
	depends on I2C
	help
	  Enable driver for PCAL9539A I2C based GPIO Expander

if GPIO_PCAL9539A

module = GPIO_PCAL9539A
module-str = gpio_pcal9539a
source "subsys/logging/Kconfig.template.log_config"

config GPIO_PCAL9539A_INIT_PRIORITY
	int "GPIO_PCAL9539A Init Priority"
	#default 66
	default 86
	help
	    Device driver initialization priority.

rsource "Kconfig.pcal9539a"

endif # GPIO_PCAL9539A
```

## pcal9539a/Kconfig.pcal9539a
```kconfig
# Copyright (c) 2021 Acme CPU
# PCAL9539A GPIO configuration options

config GPIO_PCAL9539A_INTERRUPT
	bool "Interrupt enable"
	default n
	depends on GPIO_PCAL9539A
	help
	  Enable interrupt support in PCAL9539A driver.
	  Note that the PCAL9539A cannot reliably detect
	  short-pulse interrupts due to its design.
```
