/*
 * Copyright (c) 2023 Acme CPU
 *
 * The E206 SPI1 bus is connected to the SD Card
 *
 */

&spi1 {
	status = "okay";
	pinctrl-0 = <&spi1_sck_pb3 &spi1_miso_pb4 &spi1_mosi_pb5 &spi1_nss_pg10>;
	pinctrl-names = "default";
	
	dmas = <&dmamux1 2 38 0x20440
			&dmamux1 3 37 0x20480>;
	dma-names = "tx", "rx";
	
    sdhc0: sdhc@0 {
            compatible = "zephyr,sdhc-spi-slot";
            reg = <0>;
            status = "okay";
            mmc {
                compatible = "zephyr,sdmmc-disk";
                status = "okay";
            };
            spi-max-frequency = <24000000>;
    };
};
 