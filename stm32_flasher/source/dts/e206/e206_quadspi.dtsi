/*
 * Copyright (c) 2023 Acme CPU
 *
 */

 &quadspi {
    status = "okay";
    pinctrl-0 = <&quadspi_clk_pf10 &quadspi_bk1_ncs_pb6
                 &quadspi_bk1_io0_pc9 &quadspi_bk1_io1_pc10
                 &quadspi_bk1_io2_pf7 &quadspi_bk1_io3_pf6>;
    pinctrl-names = "default";
    flash-id = <1>;
/*
	MDMA driver not implemented in zephyr
	dmas = <&dmamux1 15 40 0x0000>;
	dma-names = "tx_rx";
*/

	mt25ql256aba1: mt25ql256aba1@0 {
		compatible = "st,stm32-qspi-nor";
        /*label = "MT25QL256ABA1";*/
        reg = <0 DT_SIZE_M(256)>; /* size in mega bits */
        qspi-max-frequency = <120000000>;
        
       /* size = <DT_SIZE_M(256)>;*/	/* size in mega bits */
        
        /*jedec-id = [20 BA 19];*/
        
        spi-bus-width = <4>;
        reset-cmd;
        
        status = "okay";
        
		partitions {
			compatible = "fixed-partitions";
			#address-cells = <1>;
			#size-cells = <1>;

			data_partition: partition@0 {
				label = "data";
				reg = <0 DT_SIZE_M(32)>;
			};
		};
	};
};