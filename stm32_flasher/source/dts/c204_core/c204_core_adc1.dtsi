/*
 * Copyright (c) 2022 Acme CPU
 *
 */


/*&adc1 {
    status = "okay";
    pinctrl-0 = <&adc1_in7_pc1 &adc1_in8_pc2 &adc1_in10_pf0>;
    pinctrl-names = "default";
};*/

&adc1 {
    status = "okay";
    st,adc-clock-source = <SYNC>;
    st,adc-prescaler = <4>;
    pinctrl-0 = <&adc1_in7_pc1 &adc1_in8_pc2 &adc1_in10_pf0>;
    pinctrl-names = "default";

	#address-cells = <1>;
	#size-cells = <0>;
	
	vbus: channel@7 {
		reg = <7>;
		zephyr,gain = "ADC_GAIN_1";
		zephyr,reference = "ADC_REF_INTERNAL";
		zephyr,acquisition-time = <ADC_ACQ_TIME_DEFAULT>;
		zephyr,resolution = <12>;
		zephyr,vref-mv = <3300>;
	};

	vfan: channel@8 {
		reg = <8>;
		zephyr,gain = "ADC_GAIN_1";
		zephyr,reference = "ADC_REF_INTERNAL";
		zephyr,acquisition-time = <ADC_ACQ_TIME_DEFAULT>;
		zephyr,resolution = <12>;
	};
	
	vbatt: channel@10 {
		reg = <10>;
		zephyr,gain = "ADC_GAIN_1";
		zephyr,reference = "ADC_REF_INTERNAL";
		zephyr,acquisition-time = <ADC_ACQ_TIME_DEFAULT>;
		zephyr,resolution = <12>;
	};
};
