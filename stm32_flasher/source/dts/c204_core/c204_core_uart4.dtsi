/*
 * Copyright (c) 2022 Acme CPU
 *
 * External device interface
 *
 */


&uart4 {
    status = "okay";
    pinctrl-0 = <&uart4_rx_pc11 &uart4_tx_pc10>;
    pinctrl-names = "default";
    current-speed = <115200>;
};
