/*
 * Copyright (c) 2022 Acme CPU
 *
 * Created on: 8-Dec-2022
 * Author: Rohan Dey (rohan@acmecpu.cpm)
 *
 * H205C PWM - vibration / buzzer
 */

/ {
    vibro {
        compatible = "pwm-leds";
        vibro: vibro {
            pwms = <&pwm0 0 PWM_USEC(1000) PWM_POLARITY_NORMAL>;
        };
    };
};
