## power_control_driver/Kconfig
```kconfig
# Copyright (c) 2021 Acme CPU

menuconfig PWR_CTRL_DRV
	bool "Power Control Driver"
	help
	  Enable the Power Control Driver. This will enable / disable
	  power supplies on the board before the other application drivers
	  are loaded.
	  
if PWR_CTRL_DRV

module = PWR_CTRL_DRV
module-str = pwr_ctrl_drv
source "subsys/logging/Kconfig.template.log_config"

config PWR_CTRL_DRV_INIT_PRIORITY
	int "PWR_CTRL_DRV initialization priority"
	default 89
	help
	  PWR_CTRL_DRV initialization priority

config PWR_CTRL_DRV_SUPPLY_1
	bool "Power supply 1"
	default true
	help
	  Is Power supply 1 available

if PWR_CTRL_DRV_SUPPLY_1
	config PWR_CTRL_DRV_CONTROL_SUPPLY_1
		int "Power supply 1 (Set power supply pin to 1 or 0)"
		range 0 1
		default 1
		help
		  Set power supply pin to 1 or 0
endif # PWR_CTRL_DRV_SUPPLY_1


config PWR_CTRL_DRV_SUPPLY_2
	bool "Power supply 2"
	default false
	help
	  Is Power supply 2 available

if PWR_CTRL_DRV_SUPPLY_2
	config PWR_CTRL_DRV_CONTROL_SUPPLY_2
		int "Power supply 2 (Set power supply pin to 1 or 0)"
		range 0 1
		default 1
		help
		  Set power supply pin to 1 or 0
endif # PWR_CTRL_DRV_SUPPLY_2


config PWR_CTRL_DRV_SUPPLY_3
	bool "Power supply 3"
	default false
	help
	  Is Power supply 3 available

if PWR_CTRL_DRV_SUPPLY_3
	config PWR_CTRL_DRV_CONTROL_SUPPLY_3
		int "Power supply 3 (Set power supply pin to 1 or 0)"
		range 0 1
		default 1
		help
		  Set power supply pin to 1 or 0
endif # PWR_CTRL_DRV_SUPPLY_3


config PWR_CTRL_DRV_SUPPLY_4
	bool "Power supply 4"
	default false
	help
	  Is Power supply 4 available

if PWR_CTRL_DRV_SUPPLY_4
	config PWR_CTRL_DRV_CONTROL_SUPPLY_4
		int "Power supply 4 (Set power supply pin to 1 or 0)"
		range 0 1
		default 1
		help
		  Set power supply pin to 1 or 0
endif # PWR_CTRL_DRV_SUPPLY_4


config PWR_CTRL_DRV_SUPPLY_5
	bool "Power supply 5"
	default false
	help
	  Is Power supply 5 available

if PWR_CTRL_DRV_SUPPLY_5
	config PWR_CTRL_DRV_CONTROL_SUPPLY_5
		int "Power supply 5 (Set power supply pin to 1 or 0)"
		range 0 1
		default 1
		help
		  Set power supply pin to 1 or 0
endif # PWR_CTRL_DRV_SUPPLY_5

endif # PWR_CTRL_DRV
```

## shmax30101/Kconfig
```kconfig
# Copyright (c) 2022 Acme CPU
# SHMAX30101 sensor hub + oximeter configurations

menuconfig SHMAX30101
	bool "Maxim MAX32664 sensor hub + MAX30101 oximeter"
	depends on I2C
	help
	  Enable driver for Maxim MAX32664 sensor hub + MAX30101 oximeter

if SHMAX30101

module = SHMAX30101
module-str = shmax30101
source "subsys/logging/Kconfig.template.log_config"

config SHMAX30101_INIT_PRIORITY
	int "SHMAX30101 Init Priority"
	default APPLICATION_INIT_PRIORITY
	help
	    Device driver initialization priority.


endif # SHMAX30101
```

## stm32_flasher/source/boards/arm/c204_core/Kconfig.board
```kconfig
# C204 CORE board configuration
# Copyright (c) 2022 Acme CPU

config BOARD_C204_CORE
	bool "Acme CPU C204 Core Board"
	depends on SOC_STM32G474XX
```

## stm32_flasher/source/boards/arm/c204_core/Kconfig.defconfig
```kconfig
# C204 CORE board configuration
# Copyright (c) 2022 Acme CPU

if BOARD_C204_CORE

config BOARD
	default "c204_core"

endif # BOARD_C204_CORE
```

## stm32_flasher/source/boards/arm/e206/Kconfig.defconfig
```kconfig
# E206 board configuration

# Copyright (c) 2023 Acme CPU

if BOARD_E206

	config BOARD
		default "e206"

	#if NETWORKING
	#
	#config NET_L2_ETHERNET
	#	default y
	#
	#endif # NETWORKING

endif # BOARD_E206
```

## stm32_flasher/source/src/Kconfig
```kconfig
# Copyright (c) 2023 Acme CPU

menu "Application Configurations"

rsource "app/Kconfig"
rsource "lib/Kconfig"

endmenu
```

## stm32_flasher/source/src/app/Kconfig
```kconfig
# Copyright (c) 2023 Acme CPU

rsource "app_shellcmd/Kconfig"
rsource "app_storage/Kconfig"
rsource "app_uart/Kconfig"
```

## stm32_flasher/source/src/app/app_uart/Kconfig
```kconfig
# Copyright (c) 2023 Acme CPU
# Application UART configurations

menuconfig APP_UART
	bool "Application UART Configurations"
	default n
	help
	  Application UART module 

if APP_UART

config UART_RX_BUFFER_SIZE
	int "Size of UART rx buffer in bytes"
	default 512
	help
	  Size of UART rx buffer in bytes

endif # APP_UART
```

## stusb4500/Kconfig
```kconfig
# Copyright (c) 2023 Acme CPU
# STUSB4500 I2C UCPD sink controller

menuconfig STUSB4500
	bool "STUSB4500 UCPD sink controller"
	depends on I2C
	help
	  Enable driver for STUSB4500 I2C UCPD sink controller

if STUSB4500

module = STUSB4500
module-str = stusb4500
source "subsys/logging/Kconfig.template.log_config"

config STUSB4500_INIT_PRIORITY
	int "Init Priority"
	default APPLICATION_INIT_PRIORITY
	help
	    Device driver initialization priority.
	    
config STUSB4500_INTERRUPT
	bool "Interrupt enable"
	default n
	depends on STUSB4500
	help
	  Enable interrupt support in STUSB4500 driver.

endif # STUSB4500
```

## thermistor/Kconfig
```kconfig
config NTC_THERMISTOR
	bool "NTC Thermistor"
	default y
	depends on DT_HAS_NTC_THERMISTOR_GENERIC_ENABLED || \
		   DT_HAS_MURATA_NXFT15XH103FEAB050_ENABLED      
	select ADC
	help
	  Enable driver for Zephyr NTC Thermistor.
```
