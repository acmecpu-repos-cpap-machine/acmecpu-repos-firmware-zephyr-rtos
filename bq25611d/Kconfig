## bq25611d/Kconfig
```kconfig
# Copyright (c) 2021 Acme CPU
# BQ25611D I2C Battery Charger configurations

menuconfig BQ25611D
	bool "BQ25611D I2C Battery Charger"
#	depends on I2C_MGM_PCA95XX
	depends on I2C
	help
	  Enable driver for BQ25611D I2C Battery Charger

if BQ25611D

module = BQ25611D
module-str = bq25611d
source "subsys/logging/Kconfig.template.log_config"

config BQ25611D_INIT_PRIORITY
	int "Init Priority"
	default APPLICATION_INIT_PRIORITY
	help
	    Device driver initialization priority.

rsource "Kconfig.bq25611d"

endif # BQ25611D
```

## bq25611d/Kconfig.bq25611d
```kconfig
# Copyright (c) 2021 Acme CPU
# BQ25611D I2C Battery Charger configurations

config BQ25611D_INTERRUPT
	bool "Interrupt enable"
	default n
	depends on BQ25611D
	help
	  Enable interrupt to host support in BQ25611D driver.
	  This is used to get interrupt notifications from the battery charger  

config BQ25611D_HAS_ANALOG
	bool "Driver has analog voltage read features"
	default n
	depends on BQ25611D
	help
	  Enable analog voltage read feature of the driver. This is an additional feature
	  and not a part of the BQ25611D IC. Enabling this will allow the application to 
	  read VBUS and battery voltages
```

## bq25792/Kconfig
```kconfig
# Copyright (c) 2023 Acme CPU
# BQ25792 Single cell I2C Battery Charger configurations

menuconfig BQ25792
	bool "BQ25792 I2C Battery Charger"
	depends on I2C
	help
	  Enable driver for BQ25792 Single cell I2C Battery Charger

if BQ25792

module = BQ25792
module-str = bq25792
source "subsys/logging/Kconfig.template.log_config"

config BQ25792_INIT_PRIORITY
	int "Init Priority"
	default APPLICATION_INIT_PRIORITY
	help
	    Device driver initialization priority.
	    
config BQ25792_INTERRUPT
	bool "Interrupt enable"
	default n
	depends on BQ25792
	help
	  Enable interrupt support in BQ25792 driver.

endif # BQ25792
```

## buzzer_generic/Kconfig
```kconfig
# Generic buzzer configurations
# Copyright (c) 2021 Acme CPU

menuconfig BUZZER_GENERIC
	bool "Generic PWM Buzzer"
	default n
	help
	  Enable driver for a generic pwm buzzer

if BUZZER_GENERIC

module = BUZZER_GENERIC
module-str = buzzer_generic
source "subsys/logging/Kconfig.template.log_config"

config BUZZER_GENERIC_INIT_PRIORITY
	int "Init Priority"
	default APPLICATION_INIT_PRIORITY
	help
	    Device driver initialization priority.

endif # BUZZER_GENERIC
```

## c201_esp32/components/app_net/Kconfig
```kconfig
# Copyright (c) 2024 Acme CPU
# Network Application Configurations

menu "Network Application Configurations"

endmenu
```

## c201_esp32/components/comm_ble/Kconfig
```kconfig
# Copyright (c) 2021 Acme CPU
# ACPU Bluetooth (Application) Configurations

menu "ACPU Bluetooth (Application) Configurations"
	depends on BT_ENABLED 

	config COMM_BLE_PROFILE_NUM
		int "Number of BLE profiles"
		default 1
		help
		    Number of BLE profiles supported but the application
		    
	config COMM_BLE_APP_ID
		hex "BLE application ID"
		default 0x55
		help
		    BLE application ID
		    
	config COMM_BLE_DEVICE_NAME
		string "BLE device name"
		default "ACPU_C201"
		help
		    BLE device name
		    
	config COMM_BLE_CHAR_VAL_LEN_MAX
		int "The max length of characteristic value"
		range 20 500
		default 500
		help
		    The max length of characteristic value. When the GATT client performs a write or prepare write operation,
			the data length must be less than this value
		
	config COMM_BLE_GATT_MTU_SIZE
		int "MTU size for BT GATT service"
		default	512
		range 23 517
		help
		   	set BT GATT service's MTU size

	##### pairing mode
	choice COMM_BLE_PAIRING_SECURITY_MODE
		prompt "Select BlueTooth Security Mode"
		default BT_PAIRING_WITH_PASSKEY_INPUT
		help
			Specify BlueTooth Security type for pairing.

		config BT_PAIRING_WITH_PAIR_OPTION
			bool "BT pairing with Pair option"

		config BT_PAIRING_WITH_PASSKEY_INPUT
			bool "BT pairing with Entering the Passkey"

		config BT_PAIRING_WITH_YES_NO_OPTION
			bool "BT pairing with Yes/No option while Passkey display on the Screen"
	endchoice

	config COMM_BLE_PAIRING_SECURITY_MODE
		int
        default 0 if BT_PAIRING_WITH_PAIR_OPTION
        default 1 if BT_PAIRING_WITH_PASSKEY_INPUT
        default 2 if BT_PAIRING_WITH_YES_NO_OPTION

	##### passkey type
	choice COMM_BLE_PAIRING_PASSKEY_TYPE
		prompt "Select Bluetooth Passkey Type"
		default BT_PAIRING_WITH_STATIC_PASSKEY
		depends on BT_PAIRING_WITH_PASSKEY_INPUT
		help
			Specify BlueTooth Security type for pairing.
		
		config BT_PAIRING_WITH_STATIC_PASSKEY
			bool
			prompt "BT pairing with Static Passkey config by user"
			
		config BT_PAIRING_WITH_RANDOM_PASSKEY
			bool
			prompt "BT pairing with Random system generate Passkey"
	endchoice

	config COMM_BLE_PAIRING_PASSKEY_TYPE
		int
        default 100 if BT_PAIRING_WITH_STATIC_PASSKEY
        default 101 if BT_PAIRING_WITH_RANDOM_PASSKEY
    
        
	config BT_SECURE_PAIRING_PASSKEY_AUTO
		int
		depends on BT_PAIRING_WITH_PAIR_OPTION
		default	123456 
		
	config BT_SECURE_PAIRING_PASSKEY_STATIC
		int "BT Pairing Passkey"
		default	123456 if BT_PAIRING_WITH_STATIC_PASSKEY
		range 0 999999
		depends on (BT_PAIRING_WITH_PASSKEY_INPUT && BT_PAIRING_WITH_STATIC_PASSKEY)
		
	config BT_SECURE_PAIRING_PASSKEY_RANDOM
		int 
		default	1122334455 if BT_PAIRING_WITH_RANDOM_PASSKEY
		depends on (BT_PAIRING_WITH_PASSKEY_INPUT && BT_PAIRING_WITH_RANDOM_PASSKEY)



endmenu
```

## c201_esp32/components/comm_wifi/Kconfig
```kconfig
# Copyright (c) 20213Acme CPU
# WiFi Application Configurations

menu "WiFi Application Configurations"

endmenu
```

## c201_esp32/components/console_cmds/Kconfig
```kconfig
# Copyright (c) 2021 Acme CPU
# ACPU Console Commands Application Configurations

menu "ACPU Console Commands Application Configurations"

config CONSOLE_CMDS_APP
	int "Console commands application enable / disable"
	default 1
	help
	    Console commands application enable / disable
	    
endmenu
```

## c201_esp32/components/host_cmds/Kconfig
```kconfig
# Copyright (c) 2021 Acme CPU
# ACPU Host (Application) Processor Interface Configurations

menu "ACPU Host (Application) Processor Interface Configurations"

config HOST_IF_UART_NUMBER
	int "Connected UART Interface Number"
	range 0 2
	default 2
	help
	    The UART interface connected with the host processor
	    
choice HOST_IF_UART_HW_FLOW_CTRL
    prompt "Choose the type of flow control to use"
    default HW_FLOWCTRL_CTS_RTS
    
    config HW_FLOWCTRL_DISABLE
        bool "Do not use HW flow control"
    config HW_FLOWCTRL_RTS
        bool "enable RX hardware flow control (rts)"
    config HW_FLOWCTRL_CTS
        bool "enable TX hardware flow control (cts)"
    config HW_FLOWCTRL_CTS_RTS
        bool "enable hardware flow control"
endchoice

config HOST_IF_UART_RX_PIN
	int "Connected UART Rx Pin"
	default 16
	help
	    The Rx pin of the UART interface connected with the host processor
	    
config HOST_IF_UART_TX_PIN
	int "Connected UART Tx Pin"
	default 17
	help
	    The Tx pin of the UART interface connected with the host processor
	    
config HOST_IF_UART_RTS_PIN
	int "Connected UART RTS Pin"
	default 33
	help
	    The RTS pin of the UART interface connected with the host processor
	    
config HOST_IF_UART_CTS_PIN
	int "Connected UART CTS Pin"
	default 35
	help
	    The CTS pin of the UART interface connected with the host processor
	    
config HOST_IF_UART_RX_BUF_SIZE_BYTES
	int "Specify the RX buffer size"
	range 32 4096
	default 2048
	help
	    The Rx buffer size to use in the application
	    
config HOST_IF_UART_RETRY_MAX_COUNT
	int "Command sending to the host retry count"
	range 1 100
	default 10
	help
		Number of times a command sending action should be retried.
		
config UART_M2M_BUFFER_SIZE
	int
	default 512
	help
	    UART M2M storage of received characters or characters to send
	    
endmenu
```

## c201_esp32/components/lib/Kconfig
```kconfig
# Copyright (c) 2024 Acme CPU
# Lib C20x configurations

menu "Lib C20x Configurations"

rsource "lib_m2m_frame/Kconfig"
endmenu
```

## c201_esp32/main/Kconfig
```kconfig
# Copyright (c) 2022 Acme CPU
# Board Selection

menu "ACPU Board Selection"

choice BOARD_CHOICE
    prompt "Select the board for which the application will be built"
    default BOARD_E206
    
    config BOARD_C201
        bool "C201"
    config BOARD_C204
        bool "C204"
    config BOARD_H205C
        bool "H205C"
    config BOARD_D205
        bool "D205"
    config BOARD_E206
        bool "E206"
endchoice

endmenu

menu "ESP IDF version info"

choice ESP_IDF_VERSION
	prompt "Select the ESP IDF version"
	default IDF_V5_2_1
	
    config IDF_V4_3
        bool "IDF_V4.3"
    config IDF_V5_2_1
        bool "IDF_V5.2.1"	
endchoice
	    
endmenu
```

## c201_stm32g4/source/application/Kconfig
```kconfig
# Copyright (c) 2021 Acme CPU
# SPDX-License-Identifier: Apache-2.0

rsource "drivers/Kconfig"
```

## c201_stm32g4/source/application/drivers/Kconfig
```kconfig
# Anthem Power BSP Drivers configuration options
# Copyright (c) 2021 Acme CPU
# SPDX-License-Identifier: Apache-2.0

config ACPU_C201_BSP_DRIVER
#	bool
	bool "Enable Acme CPU BSP Driver"
	default y
	help
	    Enables Acme CPU C201 Board Support Package Driver

if ACPU_C201_BSP_DRIVER

config ACPU_C201_BSP_INIT_PRIORITY
	int
	default 80
	help
	    Board Support Package Drivers Initialization Priority

endif # ACPU_C201_BSP_DRIVER

module = ACPU_C201_BSP_DRIVER
module-str = acpu_c201_bsp_driver
source "subsys/logging/Kconfig.template.log_config"
```

## c201_stm32g4/source/boards/arm/c205/Kconfig.board
```kconfig
# C205 board configuration
# Copyright (c) 2023 Acme CPU

config BOARD_C205
	bool "Acme CPU C205 Board"
	depends on SOC_STM32G473XX
```

## c201_stm32g4/source/boards/arm/c205/Kconfig.defconfig
```kconfig
# C205 board configuration
# Copyright (c) 2023 Acme CPU

if BOARD_C205

config BOARD
	default "c205"

endif # BOARD_C205
```

## c201_stm32g4/source/boards/arm/c208t/Kconfig.board
```kconfig
# C208t board configuration

# Copyright (c) 2024 Acme CPU

config BOARD_C208T
	bool "Acme CPU C208t Board"
	depends on SOC_STM32H753XX
```

## c201_stm32g4/source/boards/arm/c208t/Kconfig.defconfig
```kconfig
# C208t board configuration

# Copyright (c) 2024 Acme CPU

if BOARD_C208T

	config BOARD
		default "c208t"

	#if NETWORKING
	#
	#config NET_L2_ETHERNET
	#	default y
	#
	#endif # NETWORKING

endif # BOARD_C208t
```

## c201_stm32g4/source/boards/arm/e206/Kconfig.board
```kconfig
# E206 board configuration

# Copyright (c) 2023 Acme CPU

config BOARD_E206
	bool "Acme CPU E206 Board"
	depends on SOC_STM32H753XX
```

## c201_stm32g4/source/boards/arm/stm32g473_acme_cpu_c201/Kconfig.board
```kconfig
# STM32G473 board configuration
# Copyright (c) 2021 Acme CPU

config BOARD_STM32G473_ACME_CPU_C201
	bool "Acme CPU C201 TFT Board"
	depends on SOC_STM32G474XX
	select BSP_ACME_CPU_C201_DRIVER
```

## c201_stm32g4/source/boards/arm/stm32g473_acme_cpu_c201_oled/Kconfig.board
```kconfig
# STM32G473 board configuration
# Copyright (c) 2021 Acme CPU

config BOARD_STM32G473_ACME_CPU_C201_OLED
	bool "Acme CPU C201 OLED Board"
	depends on SOC_STM32G474XX
	select BSP_ACME_CPU_C201_DRIVER
```
